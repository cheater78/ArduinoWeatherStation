//------------------------------------------------------------------------LIBRARIES---------------------------------------------------------------------------------------------------
#define SUPPORT_TRANSACTIONS
#include "SPI.h"
#include "Wire.h"
#include "RTClib.h"
#include "Adafruit_GFX.h"
#include "Adafruit_ILI9341.h"
#include "Adafruit_Sensor.h"
#include "Adafruit_BME680.h"
#include "XPT2046_Touchscreen.h"
#include "nRF24L01.h"
#include "RF24.h"

#include "Fonts/FreeSansBold18pt7b.h"
#include "Fonts/FreeSans9pt7b.h"
#include "Fonts/FreeSans12pt7b.h"

//------------------------------------------------------------------------DISPLAY COLORS----------------------------------------------------------------------------------------------------------------------------------------
#define BLACK 0x0000
#define NAVY 0x000F
#define DARKGREEN 0x03E0
#define DARKCYAN 0x03EF
#define MAROON 0x7800
#define PURPLE 0x780F
#define OLIVE 0x7BE0
#define LIGHTGREY 0xC618
#define DARKGREY 0x7BEF
#define BLUE 0x001F
#define GREEN 0x07E0
#define CYAN 0x07FF
#define RED 0xF800
#define MAGENTA 0xF81F
#define YELLOW 0xFFE0
#define WHITE 0xFFFF
#define ORANGE 0xFD20
#define GREENYELLOW 0xAFE5
#define PINK 0xF81F
uint16_t COLORRS = PURPLE;                                                //CHECK DEFAULT
//------------------------------------------------------------------------TFT DISPLAY CONNECTIONS----------------------------------------------------------------------------------------------------------------------------------------
#define TFT_CS    13
#define TFT_DC    12
Adafruit_ILI9341 tft = Adafruit_ILI9341(TFT_CS, TFT_DC);
//------------------------------------------------------------------------TOUCH CONNECTIONS----------------------------------------------------------------------------------------------------------------------------------------
#define T_CS  11
#define T_IRQ 10
XPT2046_Touchscreen ts(T_CS, T_IRQ);
//------------------------------------------------------------------------BME680---------------------------------------------------------------------------------------------------------------------------------------------------------
#define SEALEVELPRESSURE_HPA (1013.25)
long bmeMeasComplete;
Adafruit_BME680 bme;
//------------------------------------------------------------------------RTC------------------------------------------------------------------------------------------------------------------------------------------------------------
RTC_DS3231 rtc;
String daysNames[] = {"Sun", "Mon", "Tue", "Wed", "Thu", "Fri", "Sat" };
uint8_t currmin = 99;
uint8_t currday = 99;
//------------------------------------------------------------------------RF24-----------------------------------------------------------------------------------------------------------------------------------------------------------
RF24 radio(9, 8); // CE, CSN
const byte address[6] = "69420";

//------------------------------------------------------------------------VARS-----------------------------------------------------------------------------------------------------------------------------------------------------------
bool devMode = true;                                                      //CHECK DEFAULT
float normPresskPa = 101.325;
float storage[6][4][32];
//------------------------------------------------------------------------ICONS----------------------------------------------------------------------------------------------------------------------------------------------------------
const uint16_t icOUTSIDE[] PROGMEM = {
  BLACK,BLACK,YELLOW,BLACK,YELLOW,BLACK,YELLOW,BLACK,BLACK,BLACK,BLACK,BLACK,BLACK,BLACK,BLACK,BLACK,BLACK,BLACK,BLACK,BLACK,
  BLACK,BLACK,BLACK,YELLOW,YELLOW,YELLOW,BLACK,BLACK,BLACK,BLACK,BLACK,BLACK,BLACK,BLACK,BLACK,BLACK,BLACK,BLACK,BLACK,BLACK,
  BLACK,BLACK,YELLOW,YELLOW,YELLOW,YELLOW,YELLOW,BLACK,BLACK,BLACK,BLACK,BLACK,BLACK,BLACK,BLACK,BLACK,BLACK,BLACK,BLACK,BLACK,
  BLACK,BLACK,BLACK,YELLOW,YELLOW,YELLOW,BLACK,BLACK,BLACK,BLACK,BLACK,BLACK,BLACK,BLACK,BLACK,BLACK,BLACK,BLACK,BLACK,BLACK,
  BLACK,BLACK,YELLOW,BLACK,YELLOW,BLACK,YELLOW,BLACK,BLACK,BLACK,BLACK,BLACK,WHITE,WHITE,BLACK,WHITE,WHITE,BLACK,BLACK,BLACK,
  BLACK,BLACK,BLACK,BLACK,BLACK,BLACK,BLACK,BLACK,BLACK,BLACK,BLACK,WHITE,BLACK,BLACK,WHITE,BLACK,BLACK,WHITE,BLACK,BLACK,
  BLACK,BLACK,BLACK,BLACK,BLACK,BLACK,BLACK,BLACK,BLACK,BLACK,BLACK,BLACK,BLACK,BLACK,BLACK,BLACK,BLACK,BLACK,BLACK,BLACK,
  BLACK,BLACK,BLACK,BLACK,BLACK,BLACK,BLACK,BLACK,BLACK,BLACK,BLACK,BLACK,BLACK,BLACK,BLACK,BLACK,BLACK,BLACK,BLACK,BLACK,
  BLACK,BLACK,BLACK,BLACK,BLACK,BLACK,BLACK,BLACK,BLACK,BLACK,BLACK,BLACK,BLACK,BLACK,BLUE,BLACK,BLACK,BLACK,BLACK,BLACK,
  BLACK,BLACK,BLACK,YELLOW,BLACK,BLACK,BLACK,BLACK,PURPLE,BLACK,BLACK,BLACK,BLACK,BLUE,YELLOW,BLUE,BLACK,BLACK,BLACK,BLACK,
  BLACK,BLACK,YELLOW,ORANGE,YELLOW,BLACK,BLACK,PURPLE,RED,PURPLE,BLACK,BLACK,BLACK,GREEN,BLUE,BLACK,BLACK,BLACK,RED,BLACK,
  BLACK,BLACK,GREEN,YELLOW,BLACK,BLACK,BLACK,BLACK,PURPLE,GREEN,BLACK,BLACK,GREEN,BLACK,BLACK,BLACK,BLACK,RED,YELLOW,RED,
  BLACK,GREEN,BLACK,BLACK,BLACK,BLACK,GREEN,BLACK,BLACK,BLACK,GREEN,GREEN,BLACK,BLACK,BLACK,GREEN,BLACK,GREEN,RED,BLACK,
  BLACK,GREEN,GREEN,BLACK,BLACK,BLACK,BLACK,GREEN,GREEN,BLACK,BLACK,GREEN,GREEN,BLACK,GREEN,GREEN,BLACK,BLACK,GREEN,BLACK,
  BLACK,GREEN,BLACK,BLACK,BLACK,BLACK,BLACK,GREEN,BLACK,BLACK,BLACK,GREEN,BLACK,BLACK,BLACK,GREEN,BLACK,BLACK,GREEN,BLACK,
  GREEN,GREEN,GREEN,GREEN,GREEN,GREEN,GREEN,GREEN,GREEN,GREEN,GREEN,GREEN,GREEN,GREEN,GREEN,GREEN,GREEN,GREEN,GREEN,GREEN
};
const uint16_t icHOME[] PROGMEM = {
  BLACK,BLACK,BLACK,BLACK,BLACK,BLACK,BLACK,BLACK,BLACK,RED,RED,BLACK,BLACK,BLACK,BLACK,BLACK,BLACK,BLACK,BLACK,BLACK,
  BLACK,BLACK,BLACK,BLACK,BLACK,BLACK,BLACK,BLACK,RED,RED,RED,RED,BLACK,BLACK,BLACK,BLACK,BLACK,BLACK,BLACK,BLACK,
  BLACK,BLACK,BLACK,BLACK,BLACK,BLACK,BLACK,RED,RED,BLACK,BLACK,RED,RED,BLACK,BLACK,BLACK,BLACK,BLACK,BLACK,BLACK,
  BLACK,BLACK,BLACK,BLACK,BLACK,BLACK,RED,RED,BLACK,BLACK,BLACK,BLACK,RED,RED,BLACK,BLACK,BLACK,BLACK,BLACK,BLACK,
  BLACK,BLACK,BLACK,BLACK,BLACK,RED,RED,BLACK,BLACK,BLACK,BLACK,BLACK,BLACK,RED,RED,BLACK,BLACK,BLACK,BLACK,BLACK,
  BLACK,BLACK,BLACK,BLACK,RED,RED,BLACK,BLACK,BLACK,BLACK,BLACK,BLACK,BLACK,BLACK,RED,RED,BLACK,BLACK,BLACK,BLACK,
  BLACK,BLACK,BLACK,RED,RED,BLACK,BLACK,BLACK,BLACK,BLACK,BLACK,BLACK,BLACK,BLACK,BLACK,RED,RED,BLACK,BLACK,BLACK,
  BLACK,BLACK,RED,RED,WHITE,WHITE,WHITE,WHITE,WHITE,WHITE,WHITE,WHITE,WHITE,WHITE,WHITE,WHITE,RED,RED,BLACK,BLACK,
  BLACK,RED,RED,WHITE,BLACK,BLACK,BLACK,BLACK,BLACK,BLACK,BLACK,BLACK,BLACK,BLACK,BLACK,BLACK,WHITE,RED,RED,BLACK,
  RED,RED,BLACK,WHITE,BLACK,BLACK,BLACK,BLACK,BLACK,BLACK,BLACK,BLACK,BLACK,BLACK,BLACK,BLACK,WHITE,BLACK,RED,RED,
  BLACK,BLACK,BLACK,WHITE,BLACK,WHITE,WHITE,WHITE,WHITE,BLACK,BLACK,WHITE,WHITE,WHITE,WHITE,BLACK,WHITE,BLACK,BLACK,BLACK,
  BLACK,BLACK,BLACK,WHITE,BLACK,WHITE,BLACK,BLACK,WHITE,BLACK,BLACK,WHITE,BLACK,BLACK,WHITE,BLACK,WHITE,BLACK,BLACK,BLACK,
  BLACK,BLACK,BLACK,WHITE,BLACK,WHITE,BLACK,BLACK,WHITE,BLACK,BLACK,WHITE,BLACK,BLACK,WHITE,BLACK,WHITE,BLACK,BLACK,BLACK,
  BLACK,BLACK,BLACK,WHITE,BLACK,WHITE,WHITE,WHITE,WHITE,BLACK,BLACK,WHITE,BLACK,WHITE,WHITE,BLACK,WHITE,BLACK,BLACK,BLACK,
  BLACK,BLACK,BLACK,WHITE,BLACK,BLACK,BLACK,BLACK,BLACK,BLACK,BLACK,WHITE,BLACK,BLACK,WHITE,BLACK,WHITE,BLACK,BLACK,BLACK,
  BLACK,BLACK,BLACK,WHITE,BLACK,BLACK,BLACK,BLACK,BLACK,BLACK,BLACK,WHITE,BLACK,BLACK,WHITE,BLACK,WHITE,BLACK,BLACK,BLACK,
  BLACK,BLACK,BLACK,WHITE,WHITE,WHITE,WHITE,WHITE,WHITE,WHITE,WHITE,WHITE,WHITE,WHITE,WHITE,WHITE,WHITE,BLACK,BLACK,BLACK,
};
const uint16_t icTHERM[] PROGMEM = {
  BLACK,BLACK,BLACK,WHITE,WHITE,WHITE,WHITE,BLACK,BLACK,BLACK,
  BLACK,BLACK,WHITE,BLACK,BLACK,BLACK,BLACK,WHITE,BLACK,BLACK,
  BLACK,BLACK,WHITE,BLACK,BLACK,BLACK,WHITE,WHITE,BLACK,BLACK,
  BLACK,BLACK,WHITE,BLACK,BLACK,BLACK,BLACK,WHITE,BLACK,BLACK,
  BLACK,BLACK,WHITE,BLACK,BLACK,BLACK,WHITE,WHITE,BLACK,BLACK,
  BLACK,BLACK,WHITE,BLACK,BLACK,BLACK,BLACK,WHITE,BLACK,BLACK,
  BLACK,BLACK,WHITE,BLACK,BLACK,BLACK,WHITE,WHITE,BLACK,BLACK,
  BLACK,BLACK,WHITE,BLACK,BLACK,BLACK,BLACK,WHITE,BLACK,BLACK,
  BLACK,BLACK,WHITE,BLACK,BLACK,BLACK,WHITE,WHITE,BLACK,BLACK,
  BLACK,BLACK,WHITE,BLACK,BLACK,BLACK,BLACK,WHITE,BLACK,BLACK,
  BLACK,BLACK,WHITE,BLACK,BLACK,BLACK,WHITE,WHITE,BLACK,BLACK,
  BLACK,BLACK,WHITE,BLACK,BLACK,BLACK,BLACK,WHITE,BLACK,BLACK,
  BLACK,BLACK,WHITE,RED,RED,WHITE,WHITE,WHITE,BLACK,BLACK,
  BLACK,BLACK,WHITE,RED,RED,RED,RED,WHITE,BLACK,BLACK,
  BLACK,WHITE,RED,RED,RED,RED,RED,RED,WHITE,BLACK,
  WHITE,RED,RED,RED,RED,RED,RED,RED,RED,WHITE,
  WHITE,RED,RED,RED,RED,RED,RED,RED,RED,WHITE,
  WHITE,RED,RED,RED,RED,RED,RED,RED,RED,WHITE,
  WHITE,RED,RED,RED,RED,RED,RED,RED,RED,WHITE,
  BLACK,WHITE,RED,RED,RED,RED,RED,RED,WHITE,BLACK,
  BLACK,BLACK,WHITE,WHITE,WHITE,WHITE,WHITE,WHITE,BLACK,BLACK
};
const uint16_t icHUMID[] PROGMEM = {
  BLACK,BLACK,BLACK,BLUE,BLUE,BLACK,BLACK,BLACK,BLACK,BLACK,BLACK,BLACK,
  BLACK,BLACK,BLACK,BLUE,CYAN,BLUE,BLACK,BLACK,BLACK,BLACK,BLACK,BLACK,
  BLACK,BLACK,BLACK,BLACK,BLUE,CYAN,BLUE,BLACK,BLACK,BLACK,BLACK,BLACK,
  BLACK,BLACK,BLACK,BLACK,BLUE,CYAN,CYAN,BLUE,BLACK,BLACK,BLACK,BLACK,
  BLACK,BLACK,BLACK,BLUE,CYAN,CYAN,CYAN,BLUE,BLACK,BLACK,BLACK,BLACK,
  BLACK,BLUE,BLUE,CYAN,CYAN,CYAN,CYAN,CYAN,BLUE,BLACK,BLACK,BLACK,
  BLACK,BLUE,CYAN,BLUE,CYAN,CYAN,CYAN,CYAN,BLUE,BLUE,BLACK,BLACK,
  BLACK,BLUE,CYAN,CYAN,BLUE,CYAN,CYAN,BLUE,CYAN,CYAN,BLUE,BLACK,
  BLACK,BLACK,BLUE,CYAN,CYAN,BLUE,BLUE,CYAN,CYAN,CYAN,CYAN,BLUE,
  BLACK,BLUE,CYAN,CYAN,CYAN,BLUE,CYAN,CYAN,CYAN,CYAN,CYAN,BLUE,
  BLUE,CYAN,CYAN,CYAN,CYAN,CYAN,BLUE,CYAN,CYAN,CYAN,CYAN,BLUE,
  BLUE,CYAN,CYAN,CYAN,CYAN,CYAN,BLUE,CYAN,CYAN,CYAN,BLUE,BLACK,
  BLACK,BLUE,CYAN,CYAN,CYAN,BLUE,BLACK,BLUE,BLUE,BLUE,BLACK,BLACK,
  BLACK,BLACK,BLUE,BLUE,BLUE,BLACK,BLACK,BLACK,BLACK,BLACK,BLACK,BLACK
};

const uint16_t icBSETTINGS[] PROGMEM = {
  BLACK,BLACK,BLACK,BLACK,BLACK,BLACK,BLACK,BLACK,BLACK,BLACK,BLACK,BLACK,BLACK,BLACK,BLACK,WHITE,WHITE,WHITE,BLACK,BLACK,BLACK,BLACK,BLACK,BLACK,BLACK,BLACK,BLACK,BLACK,BLACK,BLACK,BLACK,BLACK,BLACK,
  BLACK,BLACK,BLACK,BLACK,BLACK,BLACK,BLACK,BLACK,BLACK,BLACK,BLACK,BLACK,BLACK,BLACK,WHITE,WHITE,WHITE,WHITE,WHITE,BLACK,BLACK,BLACK,BLACK,BLACK,BLACK,BLACK,BLACK,BLACK,BLACK,BLACK,BLACK,BLACK,BLACK,
  BLACK,BLACK,BLACK,BLACK,BLACK,BLACK,BLACK,BLACK,BLACK,BLACK,BLACK,BLACK,BLACK,BLACK,WHITE,WHITE,WHITE,WHITE,WHITE,BLACK,BLACK,BLACK,BLACK,BLACK,BLACK,BLACK,BLACK,BLACK,BLACK,BLACK,BLACK,BLACK,BLACK,
  BLACK,BLACK,BLACK,BLACK,BLACK,BLACK,BLACK,BLACK,BLACK,BLACK,BLACK,BLACK,BLACK,WHITE,WHITE,WHITE,WHITE,WHITE,WHITE,WHITE,BLACK,BLACK,BLACK,BLACK,BLACK,BLACK,BLACK,BLACK,BLACK,BLACK,BLACK,BLACK,BLACK,
  BLACK,BLACK,BLACK,BLACK,WHITE,WHITE,WHITE,BLACK,BLACK,BLACK,BLACK,BLACK,BLACK,WHITE,WHITE,WHITE,WHITE,WHITE,WHITE,WHITE,BLACK,BLACK,BLACK,BLACK,BLACK,BLACK,WHITE,WHITE,WHITE,BLACK,BLACK,BLACK,BLACK,
  BLACK,BLACK,BLACK,BLACK,WHITE,WHITE,WHITE,WHITE,WHITE,BLACK,BLACK,BLACK,WHITE,WHITE,WHITE,WHITE,WHITE,WHITE,WHITE,WHITE,WHITE,BLACK,BLACK,BLACK,WHITE,WHITE,WHITE,WHITE,WHITE,BLACK,BLACK,BLACK,BLACK,
  BLACK,BLACK,BLACK,BLACK,WHITE,WHITE,WHITE,WHITE,WHITE,WHITE,WHITE,WHITE,WHITE,WHITE,WHITE,WHITE,WHITE,WHITE,WHITE,WHITE,WHITE,WHITE,WHITE,WHITE,WHITE,WHITE,WHITE,WHITE,WHITE,BLACK,BLACK,BLACK,BLACK,
  BLACK,BLACK,BLACK,BLACK,BLACK,WHITE,WHITE,WHITE,WHITE,WHITE,WHITE,WHITE,WHITE,WHITE,WHITE,WHITE,WHITE,WHITE,WHITE,WHITE,WHITE,WHITE,WHITE,WHITE,WHITE,WHITE,WHITE,WHITE,BLACK,BLACK,BLACK,BLACK,BLACK,
  BLACK,BLACK,BLACK,BLACK,BLACK,WHITE,WHITE,WHITE,WHITE,WHITE,WHITE,WHITE,WHITE,WHITE,WHITE,WHITE,WHITE,WHITE,WHITE,WHITE,WHITE,WHITE,WHITE,WHITE,WHITE,WHITE,WHITE,WHITE,BLACK,BLACK,BLACK,BLACK,BLACK,
  BLACK,BLACK,BLACK,BLACK,BLACK,BLACK,WHITE,WHITE,WHITE,WHITE,WHITE,WHITE,WHITE,WHITE,BLACK,BLACK,BLACK,BLACK,BLACK,WHITE,WHITE,WHITE,WHITE,WHITE,WHITE,WHITE,WHITE,BLACK,BLACK,BLACK,BLACK,BLACK,BLACK,
  BLACK,BLACK,BLACK,BLACK,BLACK,BLACK,WHITE,WHITE,WHITE,WHITE,WHITE,WHITE,BLACK,BLACK,BLACK,BLACK,BLACK,BLACK,BLACK,BLACK,BLACK,WHITE,WHITE,WHITE,WHITE,WHITE,WHITE,BLACK,BLACK,BLACK,BLACK,BLACK,BLACK,
  BLACK,BLACK,BLACK,BLACK,BLACK,BLACK,WHITE,WHITE,WHITE,WHITE,WHITE,BLACK,BLACK,BLACK,BLACK,BLACK,BLACK,BLACK,BLACK,BLACK,BLACK,BLACK,WHITE,WHITE,WHITE,WHITE,WHITE,BLACK,BLACK,BLACK,BLACK,BLACK,BLACK,
  BLACK,BLACK,BLACK,BLACK,BLACK,WHITE,WHITE,WHITE,WHITE,WHITE,BLACK,BLACK,BLACK,BLACK,BLACK,BLACK,BLACK,BLACK,BLACK,BLACK,BLACK,BLACK,BLACK,WHITE,WHITE,WHITE,WHITE,WHITE,BLACK,BLACK,BLACK,BLACK,BLACK,
  BLACK,BLACK,BLACK,WHITE,WHITE,WHITE,WHITE,WHITE,WHITE,WHITE,BLACK,BLACK,BLACK,BLACK,BLACK,BLACK,BLACK,BLACK,BLACK,BLACK,BLACK,BLACK,BLACK,WHITE,WHITE,WHITE,WHITE,WHITE,WHITE,WHITE,BLACK,BLACK,BLACK,
  BLACK,WHITE,WHITE,WHITE,WHITE,WHITE,WHITE,WHITE,WHITE,BLACK,BLACK,BLACK,BLACK,BLACK,BLACK,BLACK,BLACK,BLACK,BLACK,BLACK,BLACK,BLACK,BLACK,BLACK,WHITE,WHITE,WHITE,WHITE,WHITE,WHITE,WHITE,WHITE,BLACK,
  WHITE,WHITE,WHITE,WHITE,WHITE,WHITE,WHITE,WHITE,WHITE,BLACK,BLACK,BLACK,BLACK,BLACK,BLACK,BLACK,BLACK,BLACK,BLACK,BLACK,BLACK,BLACK,BLACK,BLACK,WHITE,WHITE,WHITE,WHITE,WHITE,WHITE,WHITE,WHITE,WHITE,
  WHITE,WHITE,WHITE,WHITE,WHITE,WHITE,WHITE,WHITE,WHITE,BLACK,BLACK,BLACK,BLACK,BLACK,BLACK,BLACK,BLACK,BLACK,BLACK,BLACK,BLACK,BLACK,BLACK,BLACK,WHITE,WHITE,WHITE,WHITE,WHITE,WHITE,WHITE,WHITE,WHITE,
  WHITE,WHITE,WHITE,WHITE,WHITE,WHITE,WHITE,WHITE,WHITE,BLACK,BLACK,BLACK,BLACK,BLACK,BLACK,BLACK,BLACK,BLACK,BLACK,BLACK,BLACK,BLACK,BLACK,BLACK,WHITE,WHITE,WHITE,WHITE,WHITE,WHITE,WHITE,WHITE,WHITE,
  BLACK,WHITE,WHITE,WHITE,WHITE,WHITE,WHITE,WHITE,WHITE,BLACK,BLACK,BLACK,BLACK,BLACK,BLACK,BLACK,BLACK,BLACK,BLACK,BLACK,BLACK,BLACK,BLACK,BLACK,WHITE,WHITE,WHITE,WHITE,WHITE,WHITE,WHITE,WHITE,BLACK,
  BLACK,BLACK,BLACK,WHITE,WHITE,WHITE,WHITE,WHITE,WHITE,WHITE,BLACK,BLACK,BLACK,BLACK,BLACK,BLACK,BLACK,BLACK,BLACK,BLACK,BLACK,BLACK,BLACK,WHITE,WHITE,WHITE,WHITE,WHITE,WHITE,WHITE,BLACK,BLACK,BLACK,
  BLACK,BLACK,BLACK,BLACK,BLACK,WHITE,WHITE,WHITE,WHITE,WHITE,BLACK,BLACK,BLACK,BLACK,BLACK,BLACK,BLACK,BLACK,BLACK,BLACK,BLACK,BLACK,BLACK,WHITE,WHITE,WHITE,WHITE,WHITE,BLACK,BLACK,BLACK,BLACK,BLACK,
  BLACK,BLACK,BLACK,BLACK,BLACK,BLACK,WHITE,WHITE,WHITE,WHITE,WHITE,BLACK,BLACK,BLACK,BLACK,BLACK,BLACK,BLACK,BLACK,BLACK,BLACK,BLACK,WHITE,WHITE,WHITE,WHITE,WHITE,BLACK,BLACK,BLACK,BLACK,BLACK,BLACK,
  BLACK,BLACK,BLACK,BLACK,BLACK,BLACK,WHITE,WHITE,WHITE,WHITE,WHITE,WHITE,BLACK,BLACK,BLACK,BLACK,BLACK,BLACK,BLACK,BLACK,BLACK,WHITE,WHITE,WHITE,WHITE,WHITE,WHITE,BLACK,BLACK,BLACK,BLACK,BLACK,BLACK,
  BLACK,BLACK,BLACK,BLACK,BLACK,BLACK,WHITE,WHITE,WHITE,WHITE,WHITE,WHITE,WHITE,WHITE,BLACK,BLACK,BLACK,BLACK,BLACK,WHITE,WHITE,WHITE,WHITE,WHITE,WHITE,WHITE,WHITE,BLACK,BLACK,BLACK,BLACK,BLACK,BLACK,
  BLACK,BLACK,BLACK,BLACK,BLACK,WHITE,WHITE,WHITE,WHITE,WHITE,WHITE,WHITE,WHITE,WHITE,WHITE,WHITE,WHITE,WHITE,WHITE,WHITE,WHITE,WHITE,WHITE,WHITE,WHITE,WHITE,WHITE,WHITE,BLACK,BLACK,BLACK,BLACK,BLACK,
  BLACK,BLACK,BLACK,BLACK,BLACK,WHITE,WHITE,WHITE,WHITE,WHITE,WHITE,WHITE,WHITE,WHITE,WHITE,WHITE,WHITE,WHITE,WHITE,WHITE,WHITE,WHITE,WHITE,WHITE,WHITE,WHITE,WHITE,WHITE,BLACK,BLACK,BLACK,BLACK,BLACK,
  BLACK,BLACK,BLACK,BLACK,WHITE,WHITE,WHITE,WHITE,WHITE,WHITE,WHITE,WHITE,WHITE,WHITE,WHITE,WHITE,WHITE,WHITE,WHITE,WHITE,WHITE,WHITE,WHITE,WHITE,WHITE,WHITE,WHITE,WHITE,WHITE,BLACK,BLACK,BLACK,BLACK,
  BLACK,BLACK,BLACK,BLACK,WHITE,WHITE,WHITE,WHITE,WHITE,BLACK,BLACK,BLACK,WHITE,WHITE,WHITE,WHITE,WHITE,WHITE,WHITE,WHITE,WHITE,BLACK,BLACK,BLACK,WHITE,WHITE,WHITE,WHITE,WHITE,BLACK,BLACK,BLACK,BLACK,
  BLACK,BLACK,BLACK,BLACK,WHITE,WHITE,WHITE,BLACK,BLACK,BLACK,BLACK,BLACK,BLACK,WHITE,WHITE,WHITE,WHITE,WHITE,WHITE,WHITE,BLACK,BLACK,BLACK,BLACK,BLACK,BLACK,WHITE,WHITE,WHITE,BLACK,BLACK,BLACK,BLACK,
  BLACK,BLACK,BLACK,BLACK,BLACK,BLACK,BLACK,BLACK,BLACK,BLACK,BLACK,BLACK,BLACK,WHITE,WHITE,WHITE,WHITE,WHITE,WHITE,WHITE,BLACK,BLACK,BLACK,BLACK,BLACK,BLACK,BLACK,BLACK,BLACK,BLACK,BLACK,BLACK,BLACK,
  BLACK,BLACK,BLACK,BLACK,BLACK,BLACK,BLACK,BLACK,BLACK,BLACK,BLACK,BLACK,BLACK,BLACK,WHITE,WHITE,WHITE,WHITE,WHITE,BLACK,BLACK,BLACK,BLACK,BLACK,BLACK,BLACK,BLACK,BLACK,BLACK,BLACK,BLACK,BLACK,BLACK,
  BLACK,BLACK,BLACK,BLACK,BLACK,BLACK,BLACK,BLACK,BLACK,BLACK,BLACK,BLACK,BLACK,BLACK,WHITE,WHITE,WHITE,WHITE,WHITE,BLACK,BLACK,BLACK,BLACK,BLACK,BLACK,BLACK,BLACK,BLACK,BLACK,BLACK,BLACK,BLACK,BLACK,
  BLACK,BLACK,BLACK,BLACK,BLACK,BLACK,BLACK,BLACK,BLACK,BLACK,BLACK,BLACK,BLACK,BLACK,BLACK,WHITE,WHITE,WHITE,BLACK,BLACK,BLACK,BLACK,BLACK,BLACK,BLACK,BLACK,BLACK,BLACK,BLACK,BLACK,BLACK,BLACK,BLACK
};

const uint16_t icBHOME[] PROGMEM = {
  BLACK,BLACK,BLACK,BLACK,BLACK,BLACK,BLACK,BLACK,BLACK,BLACK,BLACK,BLACK,BLACK,BLACK,WHITE,WHITE,WHITE,WHITE,WHITE,BLACK,BLACK,BLACK,BLACK,BLACK,BLACK,BLACK,BLACK,BLACK,BLACK,BLACK,BLACK,BLACK,BLACK,
  BLACK,BLACK,BLACK,BLACK,BLACK,BLACK,BLACK,BLACK,BLACK,BLACK,BLACK,BLACK,BLACK,WHITE,WHITE,WHITE,WHITE,WHITE,WHITE,WHITE,BLACK,BLACK,BLACK,BLACK,BLACK,BLACK,BLACK,BLACK,BLACK,BLACK,BLACK,BLACK,BLACK,
  BLACK,BLACK,BLACK,BLACK,BLACK,BLACK,BLACK,BLACK,BLACK,BLACK,BLACK,BLACK,WHITE,WHITE,WHITE,WHITE,WHITE,WHITE,WHITE,WHITE,WHITE,BLACK,BLACK,BLACK,WHITE,WHITE,WHITE,WHITE,BLACK,BLACK,BLACK,BLACK,BLACK,
  BLACK,BLACK,BLACK,BLACK,BLACK,BLACK,BLACK,BLACK,BLACK,BLACK,BLACK,WHITE,WHITE,WHITE,WHITE,BLACK,BLACK,BLACK,WHITE,WHITE,WHITE,BLACK,BLACK,BLACK,WHITE,WHITE,WHITE,WHITE,BLACK,BLACK,BLACK,BLACK,BLACK,
  BLACK,BLACK,BLACK,BLACK,BLACK,BLACK,BLACK,BLACK,BLACK,BLACK,WHITE,WHITE,WHITE,WHITE,BLACK,BLACK,BLACK,BLACK,BLACK,WHITE,WHITE,WHITE,WHITE,BLACK,WHITE,WHITE,WHITE,WHITE,BLACK,BLACK,BLACK,BLACK,BLACK,
  BLACK,BLACK,BLACK,BLACK,BLACK,BLACK,BLACK,BLACK,BLACK,WHITE,WHITE,WHITE,WHITE,BLACK,BLACK,WHITE,WHITE,WHITE,BLACK,BLACK,WHITE,WHITE,WHITE,WHITE,WHITE,WHITE,WHITE,WHITE,BLACK,BLACK,BLACK,BLACK,BLACK,
  BLACK,BLACK,BLACK,BLACK,BLACK,BLACK,BLACK,BLACK,WHITE,WHITE,WHITE,WHITE,BLACK,BLACK,WHITE,WHITE,WHITE,WHITE,WHITE,BLACK,BLACK,WHITE,WHITE,WHITE,WHITE,WHITE,WHITE,WHITE,BLACK,BLACK,BLACK,BLACK,BLACK,
  BLACK,BLACK,BLACK,BLACK,BLACK,BLACK,BLACK,WHITE,WHITE,WHITE,WHITE,BLACK,BLACK,WHITE,WHITE,WHITE,WHITE,WHITE,WHITE,WHITE,BLACK,BLACK,WHITE,WHITE,WHITE,WHITE,WHITE,WHITE,BLACK,BLACK,BLACK,BLACK,BLACK,
  BLACK,BLACK,BLACK,BLACK,BLACK,BLACK,WHITE,WHITE,WHITE,WHITE,BLACK,BLACK,WHITE,WHITE,WHITE,WHITE,WHITE,WHITE,WHITE,WHITE,WHITE,BLACK,BLACK,WHITE,WHITE,WHITE,WHITE,WHITE,BLACK,BLACK,BLACK,BLACK,BLACK,
  BLACK,BLACK,BLACK,BLACK,BLACK,WHITE,WHITE,WHITE,WHITE,BLACK,BLACK,WHITE,WHITE,WHITE,WHITE,WHITE,WHITE,WHITE,WHITE,WHITE,WHITE,WHITE,BLACK,BLACK,WHITE,WHITE,WHITE,WHITE,BLACK,BLACK,BLACK,BLACK,BLACK,
  BLACK,BLACK,BLACK,BLACK,WHITE,WHITE,WHITE,WHITE,BLACK,BLACK,WHITE,WHITE,WHITE,WHITE,WHITE,WHITE,WHITE,WHITE,WHITE,WHITE,WHITE,WHITE,WHITE,BLACK,BLACK,WHITE,WHITE,WHITE,WHITE,BLACK,BLACK,BLACK,BLACK,
  BLACK,BLACK,BLACK,WHITE,WHITE,WHITE,WHITE,BLACK,BLACK,WHITE,WHITE,WHITE,WHITE,WHITE,WHITE,WHITE,WHITE,WHITE,WHITE,WHITE,WHITE,WHITE,WHITE,WHITE,BLACK,BLACK,WHITE,WHITE,WHITE,WHITE,BLACK,BLACK,BLACK,
  BLACK,BLACK,WHITE,WHITE,WHITE,WHITE,BLACK,BLACK,WHITE,WHITE,WHITE,WHITE,WHITE,WHITE,WHITE,WHITE,WHITE,WHITE,WHITE,WHITE,WHITE,WHITE,WHITE,WHITE,WHITE,BLACK,BLACK,WHITE,WHITE,WHITE,WHITE,BLACK,BLACK,
  BLACK,WHITE,WHITE,WHITE,WHITE,BLACK,BLACK,WHITE,WHITE,WHITE,WHITE,WHITE,WHITE,WHITE,WHITE,WHITE,WHITE,WHITE,WHITE,WHITE,WHITE,WHITE,WHITE,WHITE,WHITE,WHITE,BLACK,BLACK,WHITE,WHITE,WHITE,WHITE,BLACK,
  WHITE,WHITE,WHITE,WHITE,BLACK,BLACK,WHITE,WHITE,WHITE,WHITE,WHITE,WHITE,WHITE,WHITE,WHITE,WHITE,WHITE,WHITE,WHITE,WHITE,WHITE,WHITE,WHITE,WHITE,WHITE,WHITE,WHITE,BLACK,BLACK,WHITE,WHITE,WHITE,WHITE,
  WHITE,WHITE,WHITE,BLACK,BLACK,WHITE,WHITE,WHITE,WHITE,WHITE,WHITE,WHITE,WHITE,WHITE,WHITE,WHITE,WHITE,WHITE,WHITE,WHITE,WHITE,WHITE,WHITE,WHITE,WHITE,WHITE,WHITE,WHITE,BLACK,BLACK,WHITE,WHITE,WHITE,
  BLACK,BLACK,BLACK,BLACK,WHITE,WHITE,WHITE,WHITE,WHITE,WHITE,WHITE,WHITE,WHITE,WHITE,WHITE,WHITE,WHITE,WHITE,WHITE,WHITE,WHITE,WHITE,WHITE,WHITE,WHITE,WHITE,WHITE,WHITE,WHITE,BLACK,BLACK,BLACK,BLACK,
  BLACK,BLACK,BLACK,BLACK,WHITE,WHITE,WHITE,WHITE,WHITE,WHITE,WHITE,WHITE,WHITE,WHITE,WHITE,WHITE,WHITE,WHITE,WHITE,WHITE,WHITE,WHITE,WHITE,WHITE,WHITE,WHITE,WHITE,WHITE,WHITE,BLACK,BLACK,BLACK,BLACK,
  BLACK,BLACK,BLACK,BLACK,WHITE,WHITE,WHITE,WHITE,WHITE,WHITE,WHITE,WHITE,WHITE,WHITE,WHITE,WHITE,WHITE,WHITE,WHITE,WHITE,WHITE,WHITE,WHITE,WHITE,WHITE,WHITE,WHITE,WHITE,WHITE,BLACK,BLACK,BLACK,BLACK,
  BLACK,BLACK,BLACK,BLACK,WHITE,WHITE,WHITE,WHITE,WHITE,WHITE,WHITE,WHITE,WHITE,WHITE,WHITE,WHITE,WHITE,WHITE,WHITE,WHITE,WHITE,WHITE,WHITE,WHITE,WHITE,WHITE,WHITE,WHITE,WHITE,BLACK,BLACK,BLACK,BLACK,
  BLACK,BLACK,BLACK,BLACK,WHITE,WHITE,WHITE,WHITE,WHITE,WHITE,WHITE,WHITE,WHITE,WHITE,WHITE,WHITE,WHITE,WHITE,WHITE,WHITE,WHITE,WHITE,WHITE,WHITE,WHITE,WHITE,WHITE,WHITE,WHITE,BLACK,BLACK,BLACK,BLACK,
  BLACK,BLACK,BLACK,BLACK,WHITE,WHITE,WHITE,WHITE,WHITE,WHITE,WHITE,WHITE,BLACK,BLACK,BLACK,BLACK,BLACK,BLACK,BLACK,BLACK,BLACK,WHITE,WHITE,WHITE,WHITE,WHITE,WHITE,WHITE,WHITE,BLACK,BLACK,BLACK,BLACK,
  BLACK,BLACK,BLACK,BLACK,WHITE,WHITE,WHITE,WHITE,WHITE,WHITE,WHITE,WHITE,BLACK,BLACK,BLACK,BLACK,BLACK,BLACK,BLACK,BLACK,BLACK,WHITE,WHITE,WHITE,WHITE,WHITE,WHITE,WHITE,WHITE,BLACK,BLACK,BLACK,BLACK,
  BLACK,BLACK,BLACK,BLACK,WHITE,WHITE,WHITE,WHITE,WHITE,WHITE,WHITE,WHITE,BLACK,BLACK,BLACK,BLACK,BLACK,BLACK,BLACK,BLACK,BLACK,WHITE,WHITE,WHITE,WHITE,WHITE,WHITE,WHITE,WHITE,BLACK,BLACK,BLACK,BLACK,
  BLACK,BLACK,BLACK,BLACK,WHITE,WHITE,WHITE,WHITE,WHITE,WHITE,WHITE,WHITE,BLACK,BLACK,BLACK,BLACK,BLACK,BLACK,BLACK,BLACK,BLACK,WHITE,WHITE,WHITE,WHITE,WHITE,WHITE,WHITE,WHITE,BLACK,BLACK,BLACK,BLACK,
  BLACK,BLACK,BLACK,BLACK,WHITE,WHITE,WHITE,WHITE,WHITE,WHITE,WHITE,WHITE,BLACK,BLACK,BLACK,BLACK,BLACK,BLACK,BLACK,BLACK,BLACK,WHITE,WHITE,WHITE,WHITE,WHITE,WHITE,WHITE,WHITE,BLACK,BLACK,BLACK,BLACK,
  BLACK,BLACK,BLACK,BLACK,WHITE,WHITE,WHITE,WHITE,WHITE,WHITE,WHITE,WHITE,BLACK,BLACK,BLACK,BLACK,BLACK,BLACK,BLACK,BLACK,BLACK,WHITE,WHITE,WHITE,WHITE,WHITE,WHITE,WHITE,WHITE,BLACK,BLACK,BLACK,BLACK,
  BLACK,BLACK,BLACK,BLACK,WHITE,WHITE,WHITE,WHITE,WHITE,WHITE,WHITE,WHITE,BLACK,BLACK,BLACK,BLACK,BLACK,BLACK,BLACK,BLACK,BLACK,WHITE,WHITE,WHITE,WHITE,WHITE,WHITE,WHITE,WHITE,BLACK,BLACK,BLACK,BLACK,
  BLACK,BLACK,BLACK,BLACK,WHITE,WHITE,WHITE,WHITE,WHITE,WHITE,WHITE,WHITE,BLACK,BLACK,BLACK,BLACK,BLACK,BLACK,BLACK,BLACK,BLACK,WHITE,WHITE,WHITE,WHITE,WHITE,WHITE,WHITE,WHITE,BLACK,BLACK,BLACK,BLACK,
  BLACK,BLACK,BLACK,BLACK,WHITE,WHITE,WHITE,WHITE,WHITE,WHITE,WHITE,WHITE,BLACK,BLACK,BLACK,BLACK,BLACK,BLACK,BLACK,BLACK,BLACK,WHITE,WHITE,WHITE,WHITE,WHITE,WHITE,WHITE,WHITE,BLACK,BLACK,BLACK,BLACK,
  BLACK,BLACK,BLACK,BLACK,WHITE,WHITE,WHITE,WHITE,WHITE,WHITE,WHITE,WHITE,BLACK,BLACK,BLACK,BLACK,BLACK,BLACK,BLACK,BLACK,BLACK,WHITE,WHITE,WHITE,WHITE,WHITE,WHITE,WHITE,WHITE,BLACK,BLACK,BLACK,BLACK,
  BLACK,BLACK,BLACK,BLACK,WHITE,WHITE,WHITE,WHITE,WHITE,WHITE,WHITE,WHITE,BLACK,BLACK,BLACK,BLACK,BLACK,BLACK,BLACK,BLACK,BLACK,WHITE,WHITE,WHITE,WHITE,WHITE,WHITE,WHITE,WHITE,BLACK,BLACK,BLACK,BLACK,
  BLACK,BLACK,BLACK,BLACK,WHITE,WHITE,WHITE,WHITE,WHITE,WHITE,WHITE,WHITE,BLACK,BLACK,BLACK,BLACK,BLACK,BLACK,BLACK,BLACK,BLACK,WHITE,WHITE,WHITE,WHITE,WHITE,WHITE,WHITE,WHITE,BLACK,BLACK,BLACK,BLACK
};

const uint16_t icBGRAPH[] PROGMEM = {
  BLACK,BLACK,BLACK,BLACK,BLACK,BLACK,BLACK,BLACK,BLACK,BLACK,BLACK,BLACK,BLACK,BLACK,BLACK,BLACK,BLACK,BLACK,BLACK,BLACK,BLACK,BLACK,BLACK,BLACK,BLACK,BLACK,BLACK,BLACK,BLACK,BLACK,BLACK,BLACK,BLACK,
  BLACK,BLACK,BLACK,BLACK,BLACK,BLACK,BLACK,BLACK,BLACK,BLACK,BLACK,BLACK,BLACK,BLACK,BLACK,BLACK,BLACK,BLACK,BLACK,BLACK,BLACK,BLACK,BLACK,BLACK,BLACK,BLACK,BLACK,BLACK,BLACK,BLACK,BLACK,BLACK,BLACK,
  BLACK,BLACK,WHITE,WHITE,BLACK,BLACK,BLACK,BLACK,BLACK,BLACK,BLACK,BLACK,BLACK,BLACK,BLACK,BLACK,BLACK,BLACK,BLACK,BLACK,BLACK,BLACK,BLACK,BLACK,BLACK,BLACK,BLACK,BLACK,BLACK,BLACK,BLACK,BLACK,BLACK,
  BLACK,BLACK,WHITE,WHITE,BLACK,BLACK,BLACK,BLACK,BLACK,BLACK,BLACK,BLACK,BLACK,BLACK,BLACK,BLACK,BLACK,BLACK,BLACK,BLACK,BLACK,BLACK,BLACK,BLACK,BLACK,BLACK,BLACK,BLACK,BLACK,BLACK,BLACK,BLACK,BLACK,
  BLACK,BLACK,WHITE,WHITE,BLACK,BLACK,BLACK,BLACK,BLACK,BLACK,BLACK,BLACK,BLACK,BLACK,BLACK,BLACK,BLACK,BLACK,BLACK,BLACK,BLACK,BLACK,BLACK,BLACK,BLACK,BLACK,BLACK,BLACK,BLACK,BLACK,BLACK,BLACK,BLACK,
  BLACK,BLACK,WHITE,WHITE,BLACK,BLACK,BLACK,BLACK,BLACK,BLACK,BLACK,BLACK,BLACK,BLACK,BLACK,BLACK,BLACK,BLACK,BLACK,BLACK,BLACK,BLACK,BLACK,BLACK,BLACK,BLACK,BLACK,BLACK,BLACK,BLACK,BLACK,BLACK,BLACK,
  BLACK,BLACK,WHITE,WHITE,BLACK,BLACK,BLACK,BLACK,BLACK,BLACK,BLACK,BLACK,BLACK,BLACK,BLACK,BLACK,BLACK,BLACK,BLACK,BLACK,BLACK,BLACK,BLACK,BLACK,BLACK,BLACK,BLACK,BLACK,BLACK,BLACK,BLACK,BLACK,BLACK,
  BLACK,BLACK,WHITE,WHITE,BLACK,BLACK,BLACK,BLACK,BLACK,BLACK,BLACK,BLACK,BLACK,BLACK,BLACK,BLACK,BLACK,BLACK,BLACK,BLACK,BLACK,BLACK,BLACK,BLACK,BLACK,BLACK,BLACK,BLACK,BLACK,BLACK,BLACK,BLACK,BLACK,
  BLACK,BLACK,WHITE,WHITE,BLACK,BLACK,BLACK,BLACK,BLACK,BLACK,BLACK,BLACK,BLACK,BLACK,BLACK,BLACK,BLACK,BLACK,BLACK,BLACK,BLACK,BLACK,BLACK,BLACK,BLACK,BLACK,BLACK,BLACK,BLACK,BLACK,BLACK,BLACK,BLACK,
  BLACK,BLACK,WHITE,WHITE,BLACK,BLACK,BLACK,BLACK,BLACK,BLACK,BLACK,BLACK,BLACK,BLACK,BLACK,BLACK,BLACK,BLACK,BLACK,BLACK,BLACK,BLACK,BLACK,BLACK,BLACK,BLACK,BLACK,BLACK,BLACK,BLACK,BLACK,BLACK,BLACK,
  BLACK,BLACK,WHITE,WHITE,BLACK,BLACK,BLACK,BLACK,BLACK,BLACK,BLACK,BLACK,BLACK,BLACK,BLACK,BLACK,BLACK,BLACK,BLACK,BLACK,BLACK,BLACK,BLACK,BLACK,BLACK,BLACK,BLACK,BLACK,BLACK,BLACK,BLACK,BLACK,BLACK,
  BLACK,BLACK,WHITE,WHITE,BLACK,BLACK,BLACK,BLACK,BLACK,BLACK,BLACK,WHITE,WHITE,WHITE,BLACK,BLACK,BLACK,BLACK,BLACK,BLACK,BLACK,BLACK,BLACK,BLACK,BLACK,BLACK,BLACK,BLACK,BLACK,BLACK,BLACK,BLACK,BLACK,
  BLACK,BLACK,WHITE,WHITE,BLACK,BLACK,BLACK,BLACK,BLACK,BLACK,BLACK,WHITE,WHITE,WHITE,BLACK,BLACK,BLACK,BLACK,BLACK,BLACK,BLACK,BLACK,BLACK,BLACK,BLACK,BLACK,BLACK,BLACK,BLACK,BLACK,BLACK,BLACK,BLACK,
  BLACK,BLACK,WHITE,WHITE,BLACK,BLACK,BLACK,BLACK,BLACK,BLACK,BLACK,WHITE,WHITE,WHITE,BLACK,BLACK,BLACK,BLACK,BLACK,BLACK,BLACK,BLACK,BLACK,BLACK,BLACK,BLACK,BLACK,BLACK,BLACK,BLACK,BLACK,BLACK,BLACK,
  BLACK,BLACK,WHITE,WHITE,BLACK,BLACK,WHITE,WHITE,WHITE,BLACK,BLACK,WHITE,WHITE,WHITE,BLACK,BLACK,BLACK,BLACK,BLACK,BLACK,BLACK,BLACK,BLACK,BLACK,BLACK,BLACK,BLACK,BLACK,BLACK,BLACK,BLACK,BLACK,BLACK,
  BLACK,BLACK,WHITE,WHITE,BLACK,BLACK,WHITE,WHITE,WHITE,BLACK,BLACK,WHITE,WHITE,WHITE,BLACK,BLACK,WHITE,WHITE,WHITE,BLACK,BLACK,BLACK,BLACK,BLACK,BLACK,BLACK,BLACK,BLACK,BLACK,BLACK,BLACK,BLACK,BLACK,
  BLACK,BLACK,WHITE,WHITE,BLACK,BLACK,WHITE,WHITE,WHITE,BLACK,BLACK,WHITE,WHITE,WHITE,BLACK,BLACK,WHITE,WHITE,WHITE,BLACK,BLACK,BLACK,BLACK,BLACK,BLACK,BLACK,WHITE,WHITE,WHITE,BLACK,BLACK,BLACK,BLACK,
  BLACK,BLACK,WHITE,WHITE,BLACK,BLACK,WHITE,WHITE,WHITE,BLACK,BLACK,WHITE,WHITE,WHITE,BLACK,BLACK,WHITE,WHITE,WHITE,BLACK,BLACK,BLACK,BLACK,BLACK,BLACK,BLACK,WHITE,WHITE,WHITE,BLACK,BLACK,BLACK,BLACK,
  BLACK,BLACK,WHITE,WHITE,BLACK,BLACK,WHITE,WHITE,WHITE,BLACK,BLACK,WHITE,WHITE,WHITE,BLACK,BLACK,WHITE,WHITE,WHITE,BLACK,BLACK,BLACK,BLACK,BLACK,BLACK,BLACK,WHITE,WHITE,WHITE,BLACK,BLACK,BLACK,BLACK,
  BLACK,BLACK,WHITE,WHITE,BLACK,BLACK,WHITE,WHITE,WHITE,BLACK,BLACK,WHITE,WHITE,WHITE,BLACK,BLACK,WHITE,WHITE,WHITE,BLACK,BLACK,BLACK,BLACK,BLACK,BLACK,BLACK,WHITE,WHITE,WHITE,BLACK,BLACK,BLACK,BLACK,
  BLACK,BLACK,WHITE,WHITE,BLACK,BLACK,WHITE,WHITE,WHITE,BLACK,BLACK,WHITE,WHITE,WHITE,BLACK,BLACK,WHITE,WHITE,WHITE,BLACK,BLACK,BLACK,BLACK,BLACK,BLACK,BLACK,WHITE,WHITE,WHITE,BLACK,BLACK,BLACK,BLACK,
  BLACK,BLACK,WHITE,WHITE,BLACK,BLACK,WHITE,WHITE,WHITE,BLACK,BLACK,WHITE,WHITE,WHITE,BLACK,BLACK,WHITE,WHITE,WHITE,BLACK,BLACK,WHITE,WHITE,WHITE,BLACK,BLACK,WHITE,WHITE,WHITE,BLACK,BLACK,BLACK,BLACK,
  BLACK,BLACK,WHITE,WHITE,BLACK,BLACK,WHITE,WHITE,WHITE,BLACK,BLACK,WHITE,WHITE,WHITE,BLACK,BLACK,WHITE,WHITE,WHITE,BLACK,BLACK,WHITE,WHITE,WHITE,BLACK,BLACK,WHITE,WHITE,WHITE,BLACK,BLACK,BLACK,BLACK,
  BLACK,BLACK,WHITE,WHITE,BLACK,BLACK,WHITE,WHITE,WHITE,BLACK,BLACK,WHITE,WHITE,WHITE,BLACK,BLACK,WHITE,WHITE,WHITE,BLACK,BLACK,WHITE,WHITE,WHITE,BLACK,BLACK,WHITE,WHITE,WHITE,BLACK,BLACK,BLACK,BLACK,
  BLACK,BLACK,WHITE,WHITE,BLACK,BLACK,WHITE,WHITE,WHITE,BLACK,BLACK,WHITE,WHITE,WHITE,BLACK,BLACK,WHITE,WHITE,WHITE,BLACK,BLACK,WHITE,WHITE,WHITE,BLACK,BLACK,WHITE,WHITE,WHITE,BLACK,BLACK,BLACK,BLACK,
  BLACK,BLACK,WHITE,WHITE,BLACK,BLACK,WHITE,WHITE,WHITE,BLACK,BLACK,WHITE,WHITE,WHITE,BLACK,BLACK,WHITE,WHITE,WHITE,BLACK,BLACK,WHITE,WHITE,WHITE,BLACK,BLACK,WHITE,WHITE,WHITE,BLACK,BLACK,BLACK,BLACK,
  BLACK,BLACK,WHITE,WHITE,BLACK,BLACK,WHITE,WHITE,WHITE,BLACK,BLACK,WHITE,WHITE,WHITE,BLACK,BLACK,WHITE,WHITE,WHITE,BLACK,BLACK,WHITE,WHITE,WHITE,BLACK,BLACK,WHITE,WHITE,WHITE,BLACK,BLACK,BLACK,BLACK,
  BLACK,BLACK,WHITE,WHITE,BLACK,BLACK,WHITE,WHITE,WHITE,BLACK,BLACK,WHITE,WHITE,WHITE,BLACK,BLACK,WHITE,WHITE,WHITE,BLACK,BLACK,WHITE,WHITE,WHITE,BLACK,BLACK,WHITE,WHITE,WHITE,BLACK,BLACK,BLACK,BLACK,
  BLACK,BLACK,WHITE,WHITE,BLACK,BLACK,BLACK,BLACK,BLACK,BLACK,BLACK,BLACK,BLACK,BLACK,BLACK,BLACK,BLACK,BLACK,BLACK,BLACK,BLACK,BLACK,BLACK,BLACK,BLACK,BLACK,BLACK,BLACK,BLACK,BLACK,BLACK,BLACK,BLACK,
  BLACK,BLACK,WHITE,WHITE,WHITE,WHITE,WHITE,WHITE,WHITE,WHITE,WHITE,WHITE,WHITE,WHITE,WHITE,WHITE,WHITE,WHITE,WHITE,WHITE,WHITE,WHITE,WHITE,WHITE,WHITE,WHITE,WHITE,WHITE,WHITE,WHITE,WHITE,BLACK,BLACK,
  BLACK,BLACK,WHITE,WHITE,WHITE,WHITE,WHITE,WHITE,WHITE,WHITE,WHITE,WHITE,WHITE,WHITE,WHITE,WHITE,WHITE,WHITE,WHITE,WHITE,WHITE,WHITE,WHITE,WHITE,WHITE,WHITE,WHITE,WHITE,WHITE,WHITE,WHITE,BLACK,BLACK,
  BLACK,BLACK,BLACK,BLACK,BLACK,BLACK,BLACK,BLACK,BLACK,BLACK,BLACK,BLACK,BLACK,BLACK,BLACK,BLACK,BLACK,BLACK,BLACK,BLACK,BLACK,BLACK,BLACK,BLACK,BLACK,BLACK,BLACK,BLACK,BLACK,BLACK,BLACK,BLACK,BLACK,
  BLACK,BLACK,BLACK,BLACK,BLACK,BLACK,BLACK,BLACK,BLACK,BLACK,BLACK,BLACK,BLACK,BLACK,BLACK,BLACK,BLACK,BLACK,BLACK,BLACK,BLACK,BLACK,BLACK,BLACK,BLACK,BLACK,BLACK,BLACK,BLACK,BLACK,BLACK,BLACK,BLACK
};

const uint16_t icBSENS[] PROGMEM = {
  BLACK,BLACK,BLACK,BLACK,BLACK,BLACK,BLACK,BLACK,BLACK,BLACK,BLACK,BLACK,BLACK,BLACK,BLACK,BLACK,BLACK,BLACK,BLACK,BLACK,BLACK,BLACK,BLACK,BLACK,BLACK,BLACK,BLACK,BLACK,BLACK,BLACK,BLACK,BLACK,BLACK,
  BLACK,BLACK,BLACK,BLACK,BLACK,BLACK,BLACK,BLACK,BLACK,BLACK,BLACK,BLACK,BLACK,BLACK,BLACK,BLACK,BLACK,BLACK,BLACK,BLACK,BLACK,BLACK,BLACK,BLACK,BLACK,BLACK,BLACK,BLACK,BLACK,BLACK,BLACK,BLACK,BLACK,
  BLACK,BLACK,BLACK,BLACK,BLACK,BLACK,BLACK,BLACK,BLACK,BLACK,BLACK,BLACK,BLACK,BLACK,BLACK,BLACK,BLACK,BLACK,BLACK,BLACK,BLACK,BLACK,BLACK,BLACK,BLACK,BLACK,BLACK,BLACK,BLACK,BLACK,BLACK,BLACK,BLACK,
  BLACK,BLACK,BLACK,BLACK,BLACK,BLACK,WHITE,WHITE,BLACK,BLACK,BLACK,BLACK,BLACK,BLACK,BLACK,BLACK,BLACK,BLACK,BLACK,BLACK,BLACK,BLACK,BLACK,BLACK,BLACK,BLACK,BLACK,BLACK,BLACK,BLACK,BLACK,BLACK,BLACK,
  BLACK,BLACK,BLACK,BLACK,BLACK,BLACK,WHITE,WHITE,BLACK,BLACK,BLACK,BLACK,BLACK,BLACK,BLACK,BLACK,BLACK,BLACK,BLACK,BLACK,BLACK,BLACK,BLACK,BLACK,BLACK,BLACK,BLACK,BLACK,BLACK,BLACK,BLACK,BLACK,BLACK,
  BLACK,BLACK,BLACK,BLACK,BLACK,WHITE,WHITE,WHITE,WHITE,BLACK,BLACK,BLACK,BLACK,BLACK,BLACK,BLACK,BLACK,BLACK,BLACK,BLACK,BLACK,BLACK,BLACK,BLACK,BLACK,BLACK,BLACK,BLACK,BLACK,BLACK,BLACK,BLACK,BLACK,
  BLACK,BLACK,BLACK,BLACK,BLACK,WHITE,WHITE,WHITE,WHITE,BLACK,BLACK,BLACK,BLACK,BLACK,BLACK,BLACK,BLACK,BLACK,BLACK,BLACK,BLACK,BLACK,BLACK,BLACK,BLACK,BLACK,BLACK,BLACK,BLACK,BLACK,BLACK,BLACK,BLACK,
  BLACK,BLACK,BLACK,BLACK,WHITE,WHITE,BLACK,BLACK,WHITE,WHITE,BLACK,BLACK,BLACK,BLACK,BLACK,BLACK,BLACK,BLACK,BLACK,BLACK,BLACK,BLACK,BLACK,BLACK,BLACK,BLACK,BLACK,BLACK,BLACK,BLACK,BLACK,BLACK,BLACK,
  BLACK,BLACK,BLACK,BLACK,WHITE,WHITE,BLACK,BLACK,WHITE,WHITE,BLACK,BLACK,BLACK,BLACK,BLACK,BLACK,BLACK,BLACK,BLACK,BLACK,BLACK,BLACK,BLACK,BLACK,WHITE,WHITE,BLACK,BLACK,BLACK,BLACK,BLACK,BLACK,BLACK,
  BLACK,BLACK,BLACK,BLACK,WHITE,WHITE,BLACK,BLACK,WHITE,WHITE,BLACK,BLACK,BLACK,BLACK,BLACK,BLACK,BLACK,BLACK,BLACK,BLACK,BLACK,BLACK,BLACK,BLACK,BLACK,BLACK,WHITE,WHITE,BLACK,BLACK,BLACK,BLACK,BLACK,
  BLACK,BLACK,BLACK,BLACK,WHITE,WHITE,BLACK,BLACK,WHITE,WHITE,BLACK,BLACK,BLACK,BLACK,BLACK,BLACK,BLACK,BLACK,BLACK,BLACK,BLACK,BLACK,BLACK,BLACK,BLACK,BLACK,BLACK,BLACK,WHITE,BLACK,BLACK,BLACK,BLACK,
  BLACK,BLACK,BLACK,WHITE,WHITE,BLACK,BLACK,BLACK,BLACK,WHITE,WHITE,BLACK,BLACK,BLACK,BLACK,BLACK,BLACK,BLACK,BLACK,BLACK,BLACK,BLACK,BLACK,BLACK,WHITE,WHITE,BLACK,BLACK,BLACK,WHITE,BLACK,BLACK,BLACK,
  BLACK,BLACK,BLACK,WHITE,WHITE,BLACK,BLACK,BLACK,BLACK,WHITE,WHITE,BLACK,BLACK,BLACK,BLACK,BLACK,BLACK,BLACK,BLACK,BLACK,BLACK,BLACK,BLACK,BLACK,BLACK,BLACK,WHITE,BLACK,BLACK,WHITE,BLACK,BLACK,BLACK,
  BLACK,BLACK,BLACK,WHITE,WHITE,BLACK,BLACK,BLACK,BLACK,WHITE,WHITE,BLACK,BLACK,BLACK,BLACK,BLACK,BLACK,BLACK,BLACK,BLACK,BLACK,BLACK,BLACK,BLACK,BLACK,BLACK,BLACK,WHITE,BLACK,BLACK,WHITE,BLACK,BLACK,
  BLACK,BLACK,BLACK,WHITE,WHITE,BLACK,BLACK,BLACK,BLACK,WHITE,WHITE,BLACK,BLACK,BLACK,BLACK,BLACK,BLACK,BLACK,BLACK,BLACK,BLACK,BLACK,WHITE,WHITE,BLACK,BLACK,BLACK,WHITE,BLACK,BLACK,BLACK,WHITE,BLACK,
  WHITE,WHITE,WHITE,WHITE,BLACK,BLACK,BLACK,BLACK,BLACK,BLACK,WHITE,WHITE,BLACK,BLACK,BLACK,BLACK,BLACK,BLACK,WHITE,WHITE,WHITE,WHITE,WHITE,WHITE,WHITE,BLACK,BLACK,BLACK,WHITE,BLACK,BLACK,WHITE,BLACK,
  WHITE,WHITE,WHITE,WHITE,BLACK,BLACK,BLACK,BLACK,BLACK,BLACK,WHITE,WHITE,BLACK,BLACK,BLACK,BLACK,BLACK,BLACK,WHITE,WHITE,WHITE,WHITE,WHITE,WHITE,WHITE,BLACK,BLACK,BLACK,WHITE,BLACK,BLACK,WHITE,BLACK,
  BLACK,BLACK,BLACK,BLACK,BLACK,BLACK,BLACK,BLACK,BLACK,BLACK,BLACK,WHITE,WHITE,BLACK,BLACK,BLACK,BLACK,WHITE,WHITE,BLACK,BLACK,BLACK,WHITE,WHITE,BLACK,BLACK,BLACK,WHITE,BLACK,BLACK,BLACK,WHITE,BLACK,
  BLACK,BLACK,BLACK,BLACK,BLACK,BLACK,BLACK,BLACK,BLACK,BLACK,BLACK,WHITE,WHITE,BLACK,BLACK,BLACK,BLACK,WHITE,WHITE,BLACK,BLACK,BLACK,BLACK,BLACK,BLACK,BLACK,BLACK,WHITE,BLACK,BLACK,WHITE,BLACK,BLACK,
  BLACK,BLACK,BLACK,BLACK,BLACK,BLACK,BLACK,BLACK,BLACK,BLACK,BLACK,WHITE,WHITE,BLACK,BLACK,BLACK,BLACK,WHITE,WHITE,BLACK,BLACK,BLACK,BLACK,BLACK,BLACK,BLACK,WHITE,BLACK,BLACK,WHITE,BLACK,BLACK,BLACK,
  BLACK,BLACK,BLACK,BLACK,BLACK,BLACK,BLACK,BLACK,BLACK,BLACK,BLACK,WHITE,WHITE,BLACK,BLACK,BLACK,BLACK,WHITE,WHITE,BLACK,BLACK,BLACK,BLACK,BLACK,WHITE,WHITE,BLACK,BLACK,BLACK,WHITE,BLACK,BLACK,BLACK,
  BLACK,BLACK,BLACK,BLACK,BLACK,BLACK,BLACK,BLACK,BLACK,BLACK,BLACK,BLACK,WHITE,WHITE,BLACK,BLACK,WHITE,WHITE,BLACK,BLACK,BLACK,BLACK,BLACK,BLACK,BLACK,BLACK,BLACK,BLACK,WHITE,BLACK,BLACK,BLACK,BLACK,
  BLACK,BLACK,BLACK,BLACK,BLACK,BLACK,BLACK,BLACK,BLACK,BLACK,BLACK,BLACK,WHITE,WHITE,BLACK,BLACK,WHITE,WHITE,BLACK,BLACK,BLACK,BLACK,BLACK,BLACK,BLACK,BLACK,WHITE,WHITE,BLACK,BLACK,BLACK,BLACK,BLACK,
  BLACK,BLACK,BLACK,BLACK,BLACK,BLACK,BLACK,BLACK,BLACK,BLACK,BLACK,BLACK,WHITE,WHITE,BLACK,BLACK,WHITE,WHITE,BLACK,BLACK,BLACK,BLACK,BLACK,BLACK,WHITE,WHITE,BLACK,BLACK,BLACK,BLACK,BLACK,BLACK,BLACK,
  BLACK,BLACK,BLACK,BLACK,BLACK,BLACK,BLACK,BLACK,BLACK,BLACK,BLACK,BLACK,WHITE,WHITE,BLACK,BLACK,WHITE,WHITE,BLACK,BLACK,BLACK,BLACK,BLACK,BLACK,BLACK,BLACK,BLACK,BLACK,BLACK,BLACK,BLACK,BLACK,BLACK,
  BLACK,BLACK,BLACK,BLACK,BLACK,BLACK,BLACK,BLACK,BLACK,BLACK,BLACK,BLACK,BLACK,WHITE,WHITE,WHITE,WHITE,BLACK,BLACK,BLACK,BLACK,BLACK,BLACK,BLACK,BLACK,BLACK,BLACK,BLACK,BLACK,BLACK,BLACK,BLACK,BLACK,
  BLACK,BLACK,BLACK,BLACK,BLACK,BLACK,BLACK,BLACK,BLACK,BLACK,BLACK,BLACK,BLACK,WHITE,WHITE,WHITE,WHITE,BLACK,BLACK,BLACK,BLACK,BLACK,BLACK,BLACK,BLACK,BLACK,BLACK,BLACK,BLACK,BLACK,BLACK,BLACK,BLACK,
  BLACK,BLACK,BLACK,BLACK,BLACK,BLACK,BLACK,BLACK,BLACK,BLACK,BLACK,BLACK,BLACK,BLACK,WHITE,WHITE,BLACK,BLACK,BLACK,BLACK,BLACK,BLACK,BLACK,BLACK,BLACK,BLACK,BLACK,BLACK,BLACK,BLACK,BLACK,BLACK,BLACK,
  BLACK,BLACK,BLACK,BLACK,BLACK,BLACK,BLACK,BLACK,BLACK,BLACK,BLACK,BLACK,BLACK,BLACK,WHITE,WHITE,BLACK,BLACK,BLACK,BLACK,BLACK,BLACK,BLACK,BLACK,BLACK,BLACK,BLACK,BLACK,BLACK,BLACK,BLACK,BLACK,BLACK,
  BLACK,BLACK,BLACK,BLACK,BLACK,BLACK,BLACK,BLACK,BLACK,BLACK,BLACK,BLACK,BLACK,BLACK,BLACK,BLACK,BLACK,BLACK,BLACK,BLACK,BLACK,BLACK,BLACK,BLACK,BLACK,BLACK,BLACK,BLACK,BLACK,BLACK,BLACK,BLACK,BLACK,
  BLACK,BLACK,BLACK,BLACK,BLACK,BLACK,BLACK,BLACK,BLACK,BLACK,BLACK,BLACK,BLACK,BLACK,BLACK,BLACK,BLACK,BLACK,BLACK,BLACK,BLACK,BLACK,BLACK,BLACK,BLACK,BLACK,BLACK,BLACK,BLACK,BLACK,BLACK,BLACK,BLACK,
  BLACK,BLACK,BLACK,BLACK,BLACK,BLACK,BLACK,BLACK,BLACK,BLACK,BLACK,BLACK,BLACK,BLACK,BLACK,BLACK,BLACK,BLACK,BLACK,BLACK,BLACK,BLACK,BLACK,BLACK,BLACK,BLACK,BLACK,BLACK,BLACK,BLACK,BLACK,BLACK,BLACK,
  BLACK,BLACK,BLACK,BLACK,BLACK,BLACK,BLACK,BLACK,BLACK,BLACK,BLACK,BLACK,BLACK,BLACK,BLACK,BLACK,BLACK,BLACK,BLACK,BLACK,BLACK,BLACK,BLACK,BLACK,BLACK,BLACK,BLACK,BLACK,BLACK,BLACK,BLACK,BLACK,BLACK
};

//------------------------------------------------------------------------PREDEFS----------------------------------------------------------------------------------------------------------------------------------------
void dispError(String err = " -ERROR- ");
void msgXY(uint8_t x, uint8_t y, uint8_t sz, String msg, uint16_t color = 0xFFFF, uint16_t bgcolor = 0x0000);
bool bmeReadyRead();
//------------------------------------------------------------------------MAIN SETUP----------------------------------------------------------------------------------------------------------------------------------------
void setup() {
  SerialUSB.begin(115200);
  tftInit();
  while (!SerialUSB && (millis() <= 5000));
  dispError("Booting...");
  if(!SerialUSB) dispError("SKIPPING SERIAL");
  SerialUSB.println("#Booting...");
  
  
  tsInit();
  
  rtc.begin(); 
  if(rtc.now().year() == 2000) rtc.adjust( DateTime(2020,1,1,0,0,0) );
   
  if(!bmeInit()) dispError("!NO BME680 FOUND!");
  /*
  radio.begin();
  radio.openReadingPipe(0, address);
  radio.setPALevel(RF24_PA_MIN);
  radio.startListening();
  */
}



//------------------------------------------------------------------------MAIN LOOP----------------------------------------------------------------------------------------------------------------------------------------
#define TABHOME (tab < 20)
#define TABSETIINGS ((tab >= 20) && (tab < 40))
#define TABGRAPHS ((tab >= 40) && (tab < 60))
#define TABSENS ((tab >= 60) && (tab < 80))
#define TABUNASSIGNED00 ((tab >= 80) && (tab < 100))
bool initNeeded = true;
uint8_t tab = 0; // 0x Home | 2x Settings | 4x Graphs | 6x Sens | 8x Unassigned00 | 10x ERROR
DateTime dt;
void loop(void) {
  delayMicroseconds(1);
  dt = rtc.now();
  
  if (radio.available()) {
    char text[32] = "";
    radio.read(&text, sizeof(text));
    if(text != "")
    SerialUSB.println(String(text,DEC));

  }
  
  if(initNeeded){
    if(TABHOME) initSCHOME();
    if(TABSETIINGS) initSCSETTINGS();
    if(TABGRAPHS);
    if(TABSENS);
    if(TABUNASSIGNED00) setDevMode(!devMode);
    initNeeded = false;
  }else{
    if(TABHOME) handleHOME();
    if(TABSETIINGS) handleSETTINGS();
    if(TABGRAPHS);
    if(TABSENS);
    if(TABUNASSIGNED00);
  }

  if(ts.touched()) onTouch();
  
  yield();
}
//------------------------------------------------------------------------HANDLE---------~-----------------------------------------------------------------------------------------------------------------------------------------
//---------------------------------------------------------------------------------------~HOME---------> void handleHOME();
bool homeUpdated = false;
void handleHOME(){
  if(homeUpdated && dt.second()%2 == 1) homeUpdated = false;
  if(bmeReadyRead() && dt.second()%2 == 0 && !homeUpdated){
    //Inner
    updateTemp(roundDP(bme.temperature,1));
    updateHum(roundDP(bme.humidity,0));
    updateAirQua(bme.gas_resistance/10000);
    
    //Outer (Sensor missing)
    updateTempOut(roundDP(00.0,1));
    updateHumOut(roundDP(00,0));
    updatePreOut(101300);

    homeUpdated = true;
    if(!bmeStart()) dispError();
  }
  
  if(currmin != dt.minute()){
    updateClock(dt);
    currmin = dt.minute();
  }
  if(currday != dt.day()){
    updateDate(dt);
    currday = dt.day();
  }
}
//---------------------------------------------------------------------------------------~SETTINGS-----> void void handleSETTINGS();
void handleSETTINGS(){
  
  if(tab == 20){
  //TIME/DATE SUBTAB
    if(currmin != dt.minute()){
      tft.fillRect(41, 113-1, 85, 28, COLORRS);
      msgXYF(41-1, 113+24, 1, &FreeSansBold18pt7b, formatTime(dt), WHITE);
      currmin = dt.minute();
    }
    if(currday != dt.day()){
      tft.fillRect(191, 119, 93, 17, COLORRS);
      msgXYF(191, 119+14, 1, &FreeSans9pt7b, formatDate(dt).substring(4), WHITE);
      currday = dt.day();
    }
  }
  
}
//------------------------------------------------------------------------FUNCS----------+----------------------------------------------------------------------------------------------------------------------------------------
//------------------------------------------------------------------------------------BME+INIT---------> bool bmeInit();
bool bmeInit(){
  bool ret = bme.begin();
  // Set up oversampling and filter initialization
  bme.setTemperatureOversampling(BME680_OS_8X);
  bme.setHumidityOversampling(BME680_OS_2X);
  bme.setPressureOversampling(BME680_OS_4X);
  bme.setIIRFilterSize(BME680_FILTER_SIZE_3);
  bme.setGasHeater(320, 150); // 320*C for 150 ms
  bmeMeasComplete = bme.beginReading();
  if(bmeMeasComplete == 0) return false;
  else return ret;
}
//------------------------------------------------------------------------------------BME+-------------> bool bmeStart();
bool bmeStart(){
  if(millis() >= bmeMeasComplete) bmeMeasComplete = bme.beginReading();
  else return false;
  return true;
}
//------------------------------------------------------------------------------------BME+-------------> bool bmeReadyRead();
bool bmeReadyRead(){
  if(millis() >= bmeMeasComplete)
    if(bme.endReading())
      return true;
  return false;
}
//------------------------------------------------------------------------------------TFT+INIT---------> void tftInit();
void tftInit(){
  tft.begin();
  tft.invertDisplay(false);
  tft.setRotation(3);
  return;
}
//-------------------------------------------------------------------------------------TS+INIT---------> void tsInit();
void tsInit(){
  ts.begin();
  ts.setRotation(3);
  //SPI.usingInterrupt(digitalPinToInterrupt(T_IRQ));
  //attachInterrupt(digitalPinToInterrupt(T_IRQ), onTouch, FALLING);
  return;
}
//-------------------------------------------------------------------------------------TS+ISR----------> void onTouch();
long lastTouch = 0;
void onTouch(){
  TS_Point tp = ts.getPoint();
  uint16_t x = map(tp.x,3750,200,1,320);
  uint8_t y = map(tp.y,3870,250,1,240);
  if(millis()-lastTouch > 200){
    if(y > 200){
      if(x >= 7   && x <= 62  && tab/10 != 4 ){ tab = 40; initNeeded = true; }
      if(x >= 69  && x <= 124 && tab/10 != 6 ){ tab = 60; initNeeded = true; }
      if(x >= 132 && x <= 188 && tab/10 != 0 ){ tab = 0;  initNeeded = true; }
      if(x >= 196 && x <= 251 && tab/10 != 8 ){ tab = 80; initNeeded = true; }
      if(x >= 258 && x <= 313 && tab/10 != 2 ){ tab = 20; initNeeded = true; }
    }else{
      if(tab/10 == 0){
      //HOMETAB           ...nothing to press around here...stop it...
      }else
      if(tab/10 == 2){
      //SETTINGSTAB
        //SUBTABS [< HEAD >]
        if((y < 47) && (x < 62)  && (tab-1 >= 20)){ tab--; initNeeded = true; }
        if((y < 47) && (x > 257) && (tab+1 <  30)){ tab++; initNeeded = true; }
  
        if(tab == 20){
        //TIME/DATE SUBTAB
          //TIME BUTTONS +
          if(((y >  98) && (y < 114) && (x >  41) && (x <  59)) && (dt.hour()+10 < 24))   { rtc.adjust( DateTime(dt.year(),dt.month(),dt.day(),dt.hour()+10 ,dt.minute()    ,0) ); currmin = 99; }
          if(((y >  98) && (y < 114) && (x >  59) && (x <  77)) && (dt.hour()+1 < 24))    { rtc.adjust( DateTime(dt.year(),dt.month(),dt.day(),dt.hour()+1  ,dt.minute()    ,0) ); currmin = 99; }
          if(((y >  98) && (y < 114) && (x >  88) && (x < 106)) && (dt.minute()+10 < 60)) { rtc.adjust( DateTime(dt.year(),dt.month(),dt.day(),dt.hour()    ,dt.minute()+10 ,0) ); currmin = 99; }
          if(((y >  98) && (y < 114) && (x > 106) && (x < 126)) && (dt.minute()+1 < 60))  { rtc.adjust( DateTime(dt.year(),dt.month(),dt.day(),dt.hour()    ,dt.minute()+1  ,0) ); currmin = 99; }
          //TIME BUTTONS -
          if(((y > 139) && (y < 153) && (x >  41) && (x <  59)) && (dt.hour()-10 >= 0))   { rtc.adjust( DateTime(dt.year(),dt.month(),dt.day(),dt.hour()-10 ,dt.minute()    ,0) ); currmin = 99; }
          if(((y > 139) && (y < 153) && (x >  59) && (x <  77)) && (dt.hour()-1 >= 0))    { rtc.adjust( DateTime(dt.year(),dt.month(),dt.day(),dt.hour()-1  ,dt.minute()    ,0) ); currmin = 99; }
          if(((y > 139) && (y < 153) && (x >  88) && (x < 106)) && (dt.minute()-10 >= 0)) { rtc.adjust( DateTime(dt.year(),dt.month(),dt.day(),dt.hour()    ,dt.minute()-10 ,0) ); currmin = 99; }
          if(((y > 139) && (y < 153) && (x > 106) && (x < 126)) && (dt.minute()-1 >= 0))  { rtc.adjust( DateTime(dt.year(),dt.month(),dt.day(),dt.hour()    ,dt.minute()-1  ,0) ); currmin = 99; }
          //DATE BUTTONS +
          if(((y > 104) && (y < 120) && (x > 191) && (x < 212)) && ((dt.month() < 8) && (dt.month()%2==1) && (dt.day()+1 <= 31) || (dt.month() < 8) && (dt.month()%2==0) && (dt.month()!=2) && (dt.day()+1 <= 30) || (dt.month()==2) && (dt.day()+1 <= 29) || (dt.month() > 7) && (dt.month()%2==0) && (dt.day()+1 <= 31) || (dt.month() > 7) && (dt.month()%2==1) && (dt.day()+1 <= 30)))
          /*DAY [0,29][0,30][0,31] pwetty stwaight fowwawd :)*/                          { rtc.adjust( DateTime(dt.year()  ,dt.month()  ,dt.day()+1,dt.hour(),dt.minute(),dt.second()) ); currday = 99; }
          if(((y > 104) && (y < 120) && (x > 212) && (x < 237)) && (dt.month()+1 <= 12)) { rtc.adjust( DateTime(dt.year()  ,dt.month()+1,dt.day()  ,dt.hour(),dt.minute(),dt.second()) ); currday = 99; }
          if(((y > 104) && (y < 120) && (x > 252) && (x < 283)))                         { rtc.adjust( DateTime(dt.year()+1,dt.month()  ,dt.day()  ,dt.hour(),dt.minute(),dt.second()) ); currday = 99; }
          //DATE BUTTONS -
          if(((y > 135) && (y < 149) && (x > 191) && (x < 212)) && (dt.day()-1 > 0))    { rtc.adjust( DateTime(dt.year()  ,dt.month()  ,dt.day()-1,dt.hour(),dt.minute(),dt.second()) ); currday = 99; }
          if(((y > 135) && (y < 149) && (x > 212) && (x < 237)) && (dt.month()-1 > 0))  { rtc.adjust( DateTime(dt.year()  ,dt.month()-1,dt.day()  ,dt.hour(),dt.minute(),dt.second()) ); currday = 99; }
          if(((y > 135) && (y < 149) && (x > 252) && (x < 283)) && (dt.year()-1 >= 2020))   { rtc.adjust( DateTime(dt.year()-1,dt.month()  ,dt.day()  ,dt.hour(),dt.minute(),dt.second()) ); currday = 99; }
        }
        
      }else
      if(tab/10 == 4){
        
      }else
      if(tab/10 == 6){
        
      }else
      if(tab/10 == 8){
        
      }else{
        //if that your fucked!
      }
      
      SerialUSB.println(String(x,DEC) + " " +String(y,DEC));
    }
    lastTouch = millis();
  }
    
  return;
}
//----------------------------------------------------------------------------------CLOCK+-------------> void updateClock(uint8_t hour, uint8_t minute);
int8_t lastTime[6] = {0,0,0,0,0,0};
void updateClock(DateTime cdt){
  
  if( (lastTime[5] != cdt.hour()) || (lastTime[6] != cdt.minute()) ){
    tft.drawLine(160, 55, 160+lastTime[0], 55-lastTime[1], BLACK);
    tft.drawLine(160, 55, 160+lastTime[2], 55-lastTime[3], BLACK);

    lastTime[0] = 20*sin( 0.5235987756*((float)cdt.hour()+((float)cdt.minute()/60)) );
    lastTime[1] = 20*cos( 0.5235987756*((float)cdt.hour()+((float)cdt.minute()/60)) );
    lastTime[2] = 30*sin( 0.1047197551*(float)cdt.minute() );
    lastTime[3] = 30*cos( 0.1047197551*(float)cdt.minute() );

    tft.drawLine(160, 55, 160+lastTime[0], 55-lastTime[1], WHITE);
    tft.drawLine(160, 55, 160+lastTime[2], 55-lastTime[3], WHITE);

    tft.fillRect(118,97,85,26,COLORRS);
    lastTime[5] = cdt.hour();
    lastTime[6] = cdt.minute();
    msgXYF(117, 122, 1, &FreeSansBold18pt7b, formatTime(cdt), WHITE);
  }
  
}
//-----------------------------------------------------------------------------------DATE+-------------> void updateDate(DateTime dt);
#define DATELABELX 93
#define DATELABELY 15
void updateDate(DateTime ddt){
  tft.fillRect(DATELABELX-4, DATELABELY-14, 136, 17, COLORRS);
  tft.drawRoundRect(DATELABELX-4, DATELABELY-14, 136, 17, 5, WHITE);
  msgXYF(DATELABELX-2, DATELABELY, 1, &FreeSans9pt7b, formatDate(ddt), WHITE);
}
//-----------------------------------------------------------------------------------TEMP+-------------> void updateTemp(float t);
#define HOMETEMPX 36
#define HOMETEMPY 51
float lastTemp = 0;
void updateTemp(float t){
  if( lastTemp != t ){
    tft.fillRect(HOMETEMPX + 1, HOMETEMPY, 51, 13, COLORRS);
    tft.drawCircle(HOMETEMPX + 38, HOMETEMPY + 2, 2 ,WHITE);
    lastTemp = t;
    msgXYF(HOMETEMPX, HOMETEMPY + 12, 1, &FreeSans9pt7b, String(lastTemp,DEC).substring(0,4) + " C", WHITE);
  }
}
//------------------------------------------------------------------------------------HUM+-------------> void updateHum(float t);
#define HOMEHUMX 238
#define HOMEHUMY 51
float lastHum = 0;
void updateHum(float h){
  if( lastHum != h ){
    tft.fillRect(HOMEHUMX + 1, HOMEHUMY, 36, 13, COLORRS);
    lastHum = h;
    msgXYF(HOMEHUMX, HOMEHUMY + 12, 1, &FreeSans9pt7b, String(lastHum,DEC).substring(0,2) + "%", WHITE);
  }
}
//--------------------------------------------------------------------------------OUTTEMP+-------------> void updateTempOut(float t);
#define OUTTEMPX 36
#define OUTTEMPY 106
float lastTempOut = 0;
void updateTempOut(float t){
  if( lastTempOut != t ){
    tft.fillRect(OUTTEMPX + 1, OUTTEMPY, 51, 13, COLORRS);
    tft.drawCircle(OUTTEMPX + 38, OUTTEMPY + 2, 2 ,WHITE);
    lastTempOut = t;
    msgXYF(OUTTEMPX, OUTTEMPY + 12, 1, &FreeSans9pt7b, String(lastTempOut,DEC).substring(0,4) + " C", WHITE);
  }
}
//---------------------------------------------------------------------------------OUTHUM+-------------> void updateHumOut(float t);
#define OUTHUMX 238
#define OUTHUMY 106
float lastHumOut = 0;
void updateHumOut(float h){
  if( lastHumOut != h ){
    tft.fillRect(OUTHUMX + 1, OUTHUMY, 36, 13, COLORRS);
    lastHumOut = h;
    msgXYF(OUTHUMX, OUTHUMY + 12, 1, &FreeSans9pt7b, String(lastHumOut,DEC).substring(0,2) + "%", WHITE);
  }
}
//---------------------------------------------------------------------------------OUTPRE+-------------> void updatePreOut(float h);
#define OUTPREX 63
#define OUTPREY 163
float lastPreOut = 0;
void updatePreOut(float p){
  
  tft.fillRect(OUTPREX-44, OUTPREY - 8, 33, 29, COLORRS);
  if(p < 99000){          //SturmTief
    msgXYF(OUTPREX-35, OUTPREY + 15, 1, &FreeSans12pt7b, "T", RED);
    tft.drawCircle(OUTPREX-28,OUTPREY+6, 14, RED);
    tft.fillTriangle(OUTPREX-26-14,OUTPREY+5,OUTPREX-28-14,OUTPREY+7,OUTPREX-30-14,OUTPREY+5,RED);
    tft.fillTriangle(OUTPREX-26+14,OUTPREY+7,OUTPREX-28+14,OUTPREY+5,OUTPREX-30+14,OUTPREY+7,RED);
  }else if(p < 101000){   //Tief
    msgXYF(OUTPREX-35, OUTPREY + 15, 1, &FreeSans12pt7b, "T", WHITE);
    tft.drawCircle(OUTPREX-28,OUTPREY + 6, 14, WHITE);
    tft.fillTriangle(OUTPREX-26-14,OUTPREY+5,OUTPREX-28-14,OUTPREY+7,OUTPREX-30-14,OUTPREY+5,WHITE);
    tft.fillTriangle(OUTPREX-26+14,OUTPREY+7,OUTPREX-28+14,OUTPREY+5,OUTPREX-30+14,OUTPREY+7,WHITE);
  }else if(p < 101600){   //~Normdruck
    msgXYF(OUTPREX-36, OUTPREY + 15, 1, &FreeSans12pt7b, "N", WHITE);
    tft.drawCircle(OUTPREX-28,OUTPREY + 6, 14, WHITE);
  }else if(p >= 101600){  //Hoch
    msgXYF(OUTPREX-36, OUTPREY + 15, 1, &FreeSans12pt7b, "H", WHITE);
    tft.drawCircle(OUTPREX-28,OUTPREY + 6, 14, WHITE);
    tft.fillTriangle(OUTPREX-26+14,OUTPREY+5,OUTPREX-28+14,OUTPREY+7,OUTPREX-30+14,OUTPREY+5,WHITE);
    tft.fillTriangle(OUTPREX-26-14,OUTPREY+7,OUTPREX-28-14,OUTPREY+5,OUTPREX-30-14,OUTPREY+7,WHITE);
  }

  if( lastPreOut != p ){
    tft.fillRect(OUTPREX + 1, OUTPREY, 75, 13, COLORRS);
    lastPreOut = p;
    msgXYF(OUTPREX, OUTPREY + 12, 1, &FreeSans9pt7b,String(lastPreOut/1000,DEC).substring(0,5) + "kPa", WHITE);
  }
}
//-----------------------------------------------------------------------------------HOME+-------------> void redrawHomeStats();
void redrawHomeStats(){
  lastTemp = 0; lastHum = 0; lastTempOut = 0; lastHumOut = 0; lastPreOut = 0;
}
//---------------------------------------------------------------------------------AIRQUA+-------------> void updateHumOut(float t);
#define AIRQUAX 180
#define AIRQUAY 160
#define UPPERRES 90
#define LOWERRES 10
uint8_t aqs[8] = {30,30,30,30,30,30,30,30};
void updateAirQua(uint8_t aq){
  
  uint16_t sum = aq;
  for(uint8_t i = 0; i < 7; i++){
    aqs[i] = aqs[i+1];
    sum += aqs[i];
  }
  aqs[7] = aq;
  aq = sum/8;

  if(aq > UPPERRES) aq = UPPERRES;
  if(aq < LOWERRES) aq = LOWERRES;
  
  for(uint8_t i = 1;  i <= 56;  i++)  tft.drawFastVLine(AIRQUAX+i,AIRQUAY,20,tft.color565(map(i, 1, 56, 0, 255), 255, 0));
  for(uint8_t i = 56; i <= 113; i++)  tft.drawFastVLine(AIRQUAX+i,AIRQUAY,20,tft.color565(255, map(i, 56, 113, 255, 0), 0));
  
  tft.fillRect(AIRQUAX-5, AIRQUAY - 4, 113+12, 4, COLORRS);
  tft.fillRect(AIRQUAX-5, AIRQUAY +20, 113+12, 4, COLORRS);
  
  tft.drawFastVLine(AIRQUAX+map(aq,LOWERRES,UPPERRES,110,3),AIRQUAY,20,BLACK);
  tft.fillTriangle(AIRQUAX+map(aq,LOWERRES,UPPERRES,110,3)-3,AIRQUAY-4,AIRQUAX+map(aq,LOWERRES,UPPERRES,110,3),AIRQUAY-1,AIRQUAX+map(aq,LOWERRES,UPPERRES,110,3)+3,AIRQUAY-4,WHITE);
  tft.fillTriangle(AIRQUAX+map(aq,LOWERRES,UPPERRES,110,3)-3,AIRQUAY+23,AIRQUAX+map(aq,LOWERRES,UPPERRES,110,3),AIRQUAY+20,AIRQUAX+map(aq,LOWERRES,UPPERRES,110,3)+3,AIRQUAY+23,WHITE);
  
}
//-----------------------------------------------------------------------------------DISP+INIT---------> void initSCHOME();
void initSCHOME(){                                                        // supercreative Design Stuff 
  tft.fillScreen(BLACK);
  
  tft.drawCircle(160,55,35,WHITE);                                      // AnalogClock Outer Circle
  tft.drawRoundRect(7,7,306,131,5,WHITE);                               // UpperFrame
  tft.drawFastHLine(15, 72, 105, WHITE);
  tft.drawFastHLine(200, 72, 105, WHITE);                               

  tft.drawRoundRect(  7, 145, 306, 49, 5, WHITE);                       // MiddleFrame
  tft.drawFastVLine(160, 149, 42, WHITE);
  
  tft.drawRGBBitmap(HOMETEMPX - 16, HOMETEMPY - 5, icTHERM, 10, 21);    // HomeTemp ThermIC
  tft.drawRGBBitmap(HOMETEMPX + 16, HOMETEMPY - 24, icHOME, 20, 17);    // HomeTemp HomeIC
  tft.drawRGBBitmap(HOMEHUMX - 18, HOMEHUMY - 2, icHUMID, 12, 14);      // HomeHumid HumidIC
  tft.drawRGBBitmap(HOMEHUMX + 9, HOMEHUMY - 24, icHOME, 20, 17);       // HomeHumid HomeIC

  tft.drawRGBBitmap(OUTTEMPX - 16, OUTTEMPY - 5, icTHERM, 10, 21);      // OutTemp ThermIC
  tft.drawRGBBitmap(OUTTEMPX + 16, OUTTEMPY - 24, icOUTSIDE, 20, 17);   // OutTemp HomeIC
  tft.drawRGBBitmap(OUTHUMX - 18, OUTHUMY - 2, icHUMID, 12, 14);        // OutHumid HumidIC
  tft.drawRGBBitmap(OUTHUMX + 9, OUTHUMY - 24, icOUTSIDE, 20, 17);      // OutHumid HomeIC

  drawButtons();
  
  //initCLOCK
  lastTime[1] = 0; lastTime[2] = 0; lastTime[3] = 0; lastTime[4] = 0; lastTime[5] = 99; lastTime[6] = 99;
  updateClock(dt);
  currmin = dt.minute();
  updateDate(dt);
  currday = dt.day();
  redrawHomeStats();
}
//-----------------------------------------------------------------------------------DISP+INIT---------> void initSCHOME();
void initSCSETTINGS(){
  //reset
  tft.fillScreen(BLACK);
  //GeneralButtons
  if((tab-20) == 0){ tft.drawRoundRect(  7, 7,  55, 39, 5, WHITE); tft.fillTriangle( 32+8, 27-8,  32-8, 27,  32+8, 27+8, DARKGREY);}
  else{              tft.drawRoundRect(  7, 7,  55, 39, 5, WHITE); tft.fillTriangle( 32+8, 27-8,  32-8, 27,  32+8, 27+8, WHITE);}
  if((tab-20) == 9){ tft.drawRoundRect(258, 7,  55, 39, 5, WHITE); tft.fillTriangle(287-8, 27-8, 287+8, 27, 287-8, 27+8, DARKGREY);}
  else{              tft.drawRoundRect(258, 7,  55, 39, 5, WHITE); tft.fillTriangle(287-8, 27-8, 287+8, 27, 287-8, 27+8, WHITE);}
  drawButtons();
  //ContentFrame
  tft.drawRoundRect( 69, 7,  182, 48, 5, WHITE);
  tft.drawRoundRect( 7, 52,  306, 142, 5, WHITE);
  tft.fillRect(69, 52, 182, 3, COLORRS);

  if(tab == 20){
  //TIME/DATE SUBTAB
    tft.drawFastVLine(160,59,128,WHITE);
    //head
    tft.fillRect(98-1, 39-17, 123, 18, COLORRS);
    msgXYF(98, 39, 1, &FreeSans12pt7b, "Time / Date", WHITE);
    //time
      //Buttons
      tft.drawRoundRect(41, 113-14, 85, 26+28, 5, WHITE);
      tft.drawFastVLine(41+18, 113-14, 26+28, WHITE); tft.drawTriangle(   41+13, 113-7+4,    41+9, 113-7-4,    41+5, 113-7+4, WHITE); tft.drawTriangle(   41+13, 113+26+14-7-4,    41+9, 113+26+14-7+4,    41+5, 113+26+14-7-4, WHITE);
      tft.drawFastVLine(41+36, 113-14, 26+28, WHITE); tft.drawTriangle(41+13+18, 113-7+4, 41+9+18, 113-7-4, 41+5+18, 113-7+4, WHITE); tft.drawTriangle(41+13+18, 113+26+14-7-4, 41+9+18, 113+26+14-7+4, 41+5+18, 113+26+14-7-4, WHITE);
      tft.drawFastVLine(41+47, 113-14, 26+28, WHITE); tft.drawTriangle(41+13+47, 113-7+4, 41+9+47, 113-7-4, 41+5+47, 113-7+4, WHITE); tft.drawTriangle(41+13+47, 113+26+14-7-4, 41+9+47, 113+26+14-7+4, 41+5+47, 113+26+14-7-4, WHITE);
      tft.drawFastVLine(41+65, 113-14, 26+28, WHITE); tft.drawTriangle(41+13+65, 113-7+4, 41+9+65, 113-7-4, 41+5+65, 113-7+4, WHITE); tft.drawTriangle(41+13+65, 113+26+14-7-4, 41+9+65, 113+26+14-7+4, 41+5+65, 113+26+14-7-4, WHITE);
      tft.fillRect(41+37, 113-14, 10, 26+28, COLORRS);
      //timeData
      tft.fillRect(41, 113-1, 85, 28, COLORRS);
      msgXYF(41-1, 113+24, 1, &FreeSansBold18pt7b, formatTime(dt), WHITE);
    //date
      //Buttons
      tft.drawRoundRect(191, 119-14, 92, 16+28, 5, WHITE);
      tft.drawFastVLine(191+21, 119-14, 16+28, WHITE); tft.drawTriangle(    191+15, 119-7+4,    191+11, 119-7-4,    191+7, 119-7+4, WHITE); tft.drawTriangle(    191+15, 119+16+14-7-4,    191+11, 119+16+14-7+4,    191+7, 119+16+14-7-4, WHITE);
      tft.drawFastVLine(191+46, 119-14, 16+28, WHITE); tft.drawTriangle( 191+23+15, 119-7+4, 191+23+11, 119-7-4, 191+23+7, 119-7+4, WHITE); tft.drawTriangle( 191+23+15, 119+16+14-7-4, 191+23+11, 119+16+14-7+4, 191+23+7, 119+16+14-7-4, WHITE);
      tft.drawFastVLine(191+61, 119-14, 16+28, WHITE); tft.drawTriangle( 191+65+15, 119-7+4, 191+65+11, 119-7-4, 191+65+7, 119-7+4, WHITE); tft.drawTriangle( 191+65+15, 119+16+14-7-4, 191+65+11, 119+16+14-7+4, 191+65+7, 119+16+14-7-4, WHITE);
      tft.fillRect(191+47, 119-14, 14, 16+28, COLORRS);
      //dateData
      tft.fillRect(191, 119, 93, 17, COLORRS);
      msgXYF(191, 119+14, 1, &FreeSans9pt7b, formatDate(dt).substring(4), WHITE);

    if(devMode){  //timeButtons +/-
                  tft.drawLine(41,98,59,114,GREEN); tft.drawLine(59,98,77,114,GREEN); tft.drawLine(88,98,106,114,GREEN); tft.drawLine(106,98,126,114,GREEN);
                  tft.drawLine(41,139,59,153,GREEN); tft.drawLine(59,139,77,153,GREEN); tft.drawLine(88,139,106,153,GREEN); tft.drawLine(106,139,126,153,GREEN);
                  //dateButtons +/-
                  tft.drawLine(191, 104, 212, 120, GREEN); tft.drawLine(212, 104, 237, 120, GREEN); tft.drawLine(252, 104, 283, 120, GREEN);
                  tft.drawLine(191, 135, 212, 149, GREEN); tft.drawLine(212, 135, 237, 149, GREEN); tft.drawLine(252, 135, 283, 149, GREEN);
    }


  
  }//else Subtab 2
  
  
  
}
//---------------------------------------------------------------------------------BUTTON+INIT---------> void drawButtons();
void drawButtons(){
                                                                        //   LowerButtons:
  tft.drawRoundRect(  7, 201,  55, 44, 5, WHITE);                       //   |------------320p------------|
  tft.drawRoundRect( 69, 201,  55, 44, 5, WHITE);                       //   | |----------304p----------| |
  tft.drawRoundRect(132, 201,  56, 44, 5, WHITE);                       //    7|(55)7(55)8(56)8(55)7(55)|7
  tft.drawRoundRect(196, 201,  55, 44, 5, WHITE);                       //      *7   *69  *132 *196 *258
  tft.drawRoundRect(258, 201,  55, 44, 5, WHITE);                       //

  tft.drawRGBBitmap(18, 206, icBGRAPH, 33, 33);
  tft.drawRGBBitmap(81, 208, icBSENS, 33, 33);
  tft.drawRGBBitmap(143, 206, icBHOME, 33, 33);
  //tft.drawRGBBitmap(207, 206, ic-FILL, 33, 33);
  tft.drawRGBBitmap(269, 206, icBSETTINGS, 33, 33);

  if(TABHOME)         tft.drawFastHLine( 135,203,50,WHITE );
  if(TABSETIINGS)     tft.drawFastHLine( 261,203,49,WHITE );
  if(TABGRAPHS)       tft.drawFastHLine(  10,203,49,WHITE );
  if(TABSENS)         tft.drawFastHLine(  76,203,49,WHITE );
  if(TABUNASSIGNED00) tft.drawFastHLine( 199,203,49,WHITE );

  if(devMode){ tft.drawLine(7,200,62,240,GREEN); tft.drawLine(69,200,124,240,GREEN); tft.drawLine(132,200,188,240,GREEN); tft.drawLine(196,200,251,240,GREEN); tft.drawLine(258,200,313,240,GREEN); }
}
//---------------------------------------------------------------------------------------+-------------> float roundDP( float val, int dp );
float roundDP( float val, int dp ){
  float mul = powf( 10.0f, dp );
  val = roundf(val*mul)/mul;
  return val;
}
//---------------------------------------------------------------------------------------+-------------> void dispError(String err);
void dispError(String err){
  tft.setRotation(3);
  tft.fillScreen(BLACK);
  tft.setCursor(5,225);
  tft.setTextColor(GREEN, BLACK);
  tft.setTextSize(2);
  tft.print(err);
}
//---------------------------------------------------------------------------------------+-------------> String formatTime(DateTime dt);
String formatTime(DateTime tdt){
  String ret = "";
  if(tdt.hour() < 1){
    ret += "00";
  }else{
    if(tdt.hour() < 10) ret += "0";
    ret += String(tdt.hour(),DEC);
  }
  ret += ":";
  if(tdt.minute() < 1){
    ret += "00";
  }else{
    if(tdt.minute() < 10) ret += "0";
    ret += String(tdt.minute(),DEC);
  }
  return ret;
}
//---------------------------------------------------------------------------------------+-------------> String formatDate(DateTime dt);
String formatDate(DateTime ddt){
  String date = daysNames[ddt.dayOfTheWeek()];
  date += "-";
  if(ddt.day() < 10) date += "0";
  date += String(ddt.day(),DEC) + ".";
  if(ddt.month() < 10) date += "0";
  date += String(ddt.month(),DEC) + ".";
  date += String(ddt.year(),DEC);
  return date;
}
//---------------------------------------------------------------------------------------+-------------> void msgXY(uint8_t x, uint8_t y, uint8_t sz, String msg, uint16_t color = 0xFFFF, uint16_t bgcolor = 0x0000);
void msgXY(uint8_t x, uint8_t y, uint8_t sz, String msg, uint16_t color, uint16_t bgcolor){
  tft.setTextColor(color, bgcolor);  
  tft.setTextSize(sz);
  tft.setCursor(x, y);  
  tft.print(msg);
}
//---------------------------------------------------------------------------------------+-------------> void msgXYF(uint8_t x, uint8_t y, uint8_t sz, const GFXfont *f, String msg, uint16_t color);
void msgXYF(uint8_t x, uint8_t y, uint8_t sz, const GFXfont *f, String msg, uint16_t color){
  tft.setFont(f);
  tft.setTextColor(color);
  tft.setTextSize(sz);
  tft.setCursor(x, y);
  tft.print(msg);
}
//---------------------------------------------------------------------------------------+------------->void setDevMode(bool en);
void setDevMode(bool en){
  if(en){
    COLORRS = PURPLE;
  }else{
    COLORRS = BLACK;
  }
  devMode = en;
}


/*

1   2   3   4   5   6   7     | 8   9   10  11  12
Jan Feb Mar Apr May Jun Jul   | Aug Sep Oct Nov Dec
31  29  31  30  31  30  31    | 31  30  31  30  31

(m < 8) && (m%2==1) && (d+1 <= 31)

(m < 8) && (m%2==0) && (m!=2) && (d+1 <= 30)

(m==2) && (d+1 <= 29)

(m > 7) && (m%2==0) && (d+1 <= 31)

(m > 7) && (m%2==1) && (d+1 <= 30)

*/
